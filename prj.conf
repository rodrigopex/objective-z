## CMakeLists.txt
```
if(CONFIG_OBJZ)
    # oz2c.cmake defines objz_transpile_sources(), the entry point every
    # sample calls. This used to point at oz_transpile.cmake, which dispatched
    # between the Rust and Python backends; the Python one is retired (see the
    # `python-backend-final` tag) so there is nothing left to dispatch on.
    include(${ZEPHYR_OBJZ_MODULE_DIR}/cmake/oz2c.cmake)
else()
    # Stubs that explain themselves, for the case where an application calls
    # the entry point with CONFIG_OBJZ off (#611).
    #
    # Without these the call is simply an unknown command, and CMake reports
    # `Unknown CMake command "objz_transpile_sources"` pointing at the
    # application's own line. That names the consequence and not the cause:
    # the reason the function does not exist is that the `include()` above did
    # not run, which is hundreds of log lines away and shares no vocabulary
    # with the error. A reader new to this concludes the sample or the module
    # installation is broken.
    #
    # It has to be a stub rather than a bare message(FATAL_ERROR) in this
    # `else()`. A Zephyr module's CMakeLists.txt is processed for *every*
    # application in the workspace, so erroring here would break every build
    # that does not use Objective-Z at all. Only a call is evidence that
    # someone wanted the transpiler, so only a call may fail.
    #
    # Both names are stubbed. `objz_transpile_sources()` is what the 18
    # samples and the benchmarks call, and `objz_transpile_sources_static()`
    # is documented as public in cmake/oz2c.cmake even though nothing
    # in-tree calls it, so an out-of-tree consumer may.
    macro(_objz_unavailable fn)
        message(FATAL_ERROR
            "${fn}() requires CONFIG_OBJZ, which is not enabled for board "
            "'${BOARD}'.\n"
            "Add CONFIG_OBJZ=y to the application's prj.conf, or to a "
            "board-specific .conf. If it is already set there, Kconfig could "
            "not honour it: look earlier in this log for a warning naming "
            "OBJZ and the dependency it could not satisfy.")
    endmacro()

    function(objz_transpile_sources target)
        _objz_unavailable(objz_transpile_sources)
    endfunction()

    function(objz_transpile_sources_static target)
        _objz_unavailable(objz_transpile_sources_static)
    endfunction()
endif()
```

## Kconfig
```
menuconfig OBJZ
	bool "Objective-Z transpiler support"
	depends on CPU_CORTEX_M || CPU_CORTEX_A || (RISCV && !RISCV_ISA_RV32E) || X86
	select STATIC_INIT_GNU
	help
	  Enable Objective-Z transpiled C support with the Platform
	  Abstraction Layer (PAL). The transpiler converts Objective-C
	  (.m) sources to plain C at build time via Clang AST analysis.

	  The architecture list here is not a statement about the
	  generated C, which Zephyr's own toolchain compiles. It mirrors
	  the triples in _objz_get_clang_target_triple()
	  (cmake/ObjcClang.cmake), because the Clang AST dump oz2c reads
	  as an ownership oracle has to be parsed for the target: the arch
	  headers carry inline asm whose register names and constraints
	  Clang checks against the triple, and a mismatch fails the dump
	  outright rather than degrading it.

	  Adding an architecture means adding both, plus a gate that
	  builds and runs it. tests/arch_support_is_declared_once.rs
	  keeps the two lists in step (#612).

	  Collections need one option this deliberately does not turn on:
	  CONFIG_SYS_MEM_BLOCKS=y. OZArray, OZDictionary and the @[...]
	  and @{...} literals draw their element buffers from Zephyr's
	  contiguous block allocator, which is behind that option and
	  defaults to n. It stays opt-in because whether a program uses a
	  collection is a property of its Objective-C, not of its
	  configuration -- most programs use none, and a select here would
	  take away their ability to say n. A program that does need it
	  and has not set it stops at the item pool's definition with a
	  BUILD_ASSERT naming the option, rather than at the link with
	  undefined references into the PAL (#366).

	  Leaving it on costs a program that uses no collection nothing:
	  samples/hello_category is 26808 B flash and 6852 B RAM on
	  mps2/an385 either way, because --gc-sections drops the whole
	  library when nothing calls it.

if OBJZ

# The transpiler. There used to be a choice here between the Rust pipeline
# and a Python one (oz_transpile); the Python backend is retired, so
# CONFIG_OBJZ_BACKEND_STATIC is unconditional and CONFIG_OBJZ_BACKEND_PYTHON
# no longer exists. A build that still sets it will fail Kconfig's unknown
# symbol check rather than silently selecting something else.
#
# The implementation is readable at the `python-backend-final` tag.
config OBJZ_BACKEND_STATIC
	bool
	default y
	help
	  The transpiler: .m -> tree-sitter CST -> oz2c -> .h + .c. Rejects
	  anything outside its supported subset with a located error rather
	  than emitting code that misbehaves.

config OBJZ_INTROSPECTION
	bool "Type introspection (-isKindOfClass:, -conformsToProtocol:)"
	default y
	help
	  Answer -isKindOfClass: and -conformsToProtocol: from tables
	  generated at transpile time -- a superclass chain indexed by
	  class id, and one conformance bitmap per protocol. Both are
	  const, so they cost flash and no RAM, and neither is emitted
	  unless some call site actually uses it: a program that does not
	  introspect pays nothing for leaving this on.

	  Class identity is not covered here and is always available:
	  [Foo class] is a compile-time constant, and [obj class] and
	  -isMemberOfClass: read the class id every object already carries.

	  Set n to forbid type introspection outright -- for code-size or
	  certification discipline. Both selectors then become located
	  transpile errors naming this option, never silently unavailable.

config OBJZ_NIL_SAFE_SENDS
	bool "Nil-safe message sends"
	default y
	help
	  Give Objective-C's nil-receiver rule its behaviour: a message
	  sent to nil is a no-op answering 0 / nil / a zeroed struct,
	  rather than a dereference of a null receiver.

	  Without this a send lowers to a direct call with self == NULL
	  and the method body reads self->_field. On mps2/an385 address 0
	  is flash, so that returns a plausible number and drifts between
	  builds; on a part that traps a null read it faults instead. It
	  is how a second singleton's +initialize read 20385 where the
	  value was 80.

	  Two guards implement it, and both are needed. Each instance
	  method tests its receiver on entry, which covers a direct call.
	  Each OZ_PROTOCOL_SEND_* dispatcher tests it before switching on
	  the class id, because that read happens before any method body
	  is reached. A class method needs neither: it is emitted as
	  Foo_bar_cls(void) with no receiver at all.

	  Cost, measured across 17 configurations on mps2/an385: .text
	  +832 bytes (+0.22%), data and bss unchanged. Most of it is
	  optimised or linked away -- 65 guards are emitted for a minimal
	  two-class program and only the reachable ones survive.

	  Say n only to buy those bytes back, and expect [[Foo
	  sharedInstance] bar] to fault when the singleton is not up yet.
	  The idiom depends on this rule.

config OBJZ_REFLECTION
	bool "Selectors (@selector, SEL, -respondsToSelector:, -performSelector:)"
	default y
	help
	  Make @selector(...) and SEL real values, and answer
	  -respondsToSelector: and the -performSelector: family from them.

	  A SEL is a pointer to a const record per selector some
	  @selector(...) names: a responds bitmap keyed by class id, and a
	  uniform-shape wrapper so an indirect call needs no cast and no
	  variadics. Costs more than introspection when used -- roughly 16
	  bytes of flash per selector plus the dispatch function it forces
	  into existence for a selector that had only one implementor -- and
	  still nothing at all for a program that names no selector.

	  Because a SEL is a value, there is no way to prove which selector
	  reaches which -performSelector: call site. So in a program that
	  performs, every selector named by a @selector(...) must be
	  performable: at most two arguments, all object-typed, returning
	  void or an object. One that is not is a located transpile error
	  rather than a runtime surprise.

	  Set n to forbid selectors outright. All four constructs then
	  become located transpile errors naming this option.

config OBJZ_DEBUG_REFCOUNT
	bool "Refcount traps: catch an over-release or a stale pointer"
	default n
	help
	  Emit the refcount instruments as OZ_DEBUG_REFCOUNT, which is
	  off by default because each one costs a branch on every retain and
	  release.

	  What it catches, and why each is otherwise silent:

	  An over-release. oz_atomic_dec_and_test is a fetch-sub compared
	  against 1, so releasing an object at refcount 0 leaves -1 and
	  returns as though nothing happened. A dealloc counter cannot see it
	  either, because the refcount never reaches 0 again, and nor can a
	  slot count, because oz_slab_free clamps rather than underflowing.
	  The trap checks before the decrement, where the evidence still
	  exists.

	  A retain during dealloc, which resurrects a reference the dealloc
	  switch has already passed, so the object is freed under its new
	  owner.

	  A retain or release of a slot already returned to its slab. _oz_free
	  stamps OZ_REFCOUNT_FREED into the refcount word on its way out, and
	  both entry points check for it first. The trap names the slot by
	  address rather than by class, because the class is genuinely gone:
	  see below.

	  A release whose class_id matches no live class -- a corrupt pointer.
	  That arm of the dealloc switch was a silent break, which returns as
	  though the object had been deallocated.

	  This is the only instrument that catches a use-after-free on target,
	  where AddressSanitizer does not exist. On the host the sanitizers
	  are the stronger tool and the corpora already run under them; this
	  is what covers the boards.

	  What it does NOT catch, stated because the shape of the code invites
	  the opposite assumption (#490):

	  A use of a slot that has since been REALLOCATED. The marker lives in
	  the block, so the next allocation clears it and the trap falls
	  silent. Detecting that needs a mechanism outside the block -- a side
	  table or a generation counter -- and neither exists here. On target
	  this is uncovered; on the host it is ASan's.

	  Anything through the class_id stamp. OZ_CLASS_ID_FREED is written
	  into _meta, which is the root struct's first member, and
	  k_mem_slab_free writes its free-list link over exactly those bytes.
	  Measured, the id reads back as the link's low bits -- 588 on
	  mps2/an385, 376 on qemu_cortex_a53 -- so oz_class_name answers "?"
	  and not "freed". The stamp is legible only in the cases with no
	  free-list write: a slab-less class, and the hand-off to a waiting
	  thread. An instrument placed inside the thing it watches is
	  destroyed by the event it watches for; the refcount word survives
	  only because it begins just past the link.

	  OZ_DEBUG_REFCOUNT is the macro name, and a -D flag is the one
	  interface here with no deprecation path. An out-of-tree build
	  passing the pre-#472 spelling gets no diagnostic -- just an #ifdef
	  that never fires and instruments that silently are not there. That
	  is the same reason OZ_TRAP_POOL_EXHAUSTION kept a name it had
	  outgrown. Renaming this macro again means saying so in a release
	  note, because nothing in the build can say it for you. The retired
	  spelling is written out once, in docs/STATUS.md, which is the only
	  file permitted to carry it.

config OBJZ_DEBUG_LINES
	bool "#line directives back to the Objective-C source"
	depends on DEBUG
	default y
	help
	  Put #line directives on the generated C, so the toolchain
	  resolves a transpiled program's addresses to the .m the code was
	  written in rather than to oz2c_generated/<Class>.c, the only
	  file the C compiler is ever handed.

	  With this on, break PXLEDController.m:161, list, step and info
	  line work in Objective-C terms; a fatal-error backtrace,
	  addr2line and west debug name the .m; a GCC warning about
	  generated code quotes the Objective-C that produced it; and
	  coverage attributes to the .m. Paths are absolute, so a debugger
	  resolves them from any working directory.

	  Free of image, and not free of source. #line changes only what
	  the compiler records about the code, not the code, so every
	  generated .o's instructions are byte-identical with it on. The
	  one thing that moves is __FILE__, which then expands to the .m
	  inside generated code, so an __ASSERT failure names the
	  Objective-C as well -- and the image gets slightly smaller,
	  since a .m name is shorter than a generated .c path: 26848 bytes
	  against 26932 for samples/hello_category on mps2/an385.

	  What it costs is the generated C itself, which is what a
	  maintainer reads when the transpiler is the thing under
	  suspicion. Every directive carries an absolute path, so the text
	  roughly doubles: that sample's main.c goes from 2658 bytes to
	  5766, and #line accounts for 38% of the bytes in px-keyboard's
	  whole generated tree, 31% to 55% file by file. Those figures
	  track how deep the build directory sits, the paths being
	  absolute, so they are a shape rather than a constant.

	  So this depends on CONFIG_DEBUG and is y within it (#395). A
	  debugging build gets .m attribution; a release build gets
	  generated C worth reading, and hands back that ~100 bytes of
	  flash.

	  #358 made only the default follow CONFIG_DEBUG, leaving y
	  reachable by hand in a release build on the grounds that a field
	  fault is what has to be resolved against the .m. That does not
	  survive: reading a release image's addresses in .m terms needs the
	  directives to have been in the build that shipped, and a build
	  that sets CONFIG_DEBUG to get them is at -Og with asserts on --
	  a different image, so the hatch answers a different question than
	  the one it was kept for. What it did leave reachable was y in a
	  configuration where the directives are pure cost.

	  Covered: method bodies, plain C function bodies and the functions
	  hoisted from block literals -- the code you actually step
	  through. Code oz2c synthesizes (slab definitions,
	  _oz_release_ivars, dispatch thunks, introspection tables) keeps
	  pointing at the generated .c, which is where it genuinely lives.

	  Set n to read the generated C directly without line markers in
	  it, or if some tool in the chain mishandles them.

config OBJZ_DEFAULT_DESCRIPTION
	bool "Default -getDescription:maxLength: naming the class"
	default y
	help
	  Give every class an inherited description of the form
	  <ClassName: 0xADDRESS>, so OZLog's %@ names an object rather
	  than printing nothing. A class that writes its own
	  -getDescription:maxLength: overrides it either way; this only
	  decides what the classes that do not write one produce.

	  Costs ~360 bytes of flash, and costs them on every program that
	  calls OZLog at all -- not only those using %@. The %@ branch
	  lives in OZLog's body and the format string is a run-time
	  value, so the linker cannot know the branch is unreachable and
	  keeps the whole chain behind it: the protocol dispatch,
	  OZObject's implementation (176 bytes, of which 110 is formatting
	  the address), the synthesized oz_class_name (40 bytes) and
	  one name string per class. Measured on mps2/an385:
	  samples/hello_category, which contains no %@ at all, is
	  26820 bytes with this on and 26456 with it off.

	  Set n to get all of it back -- with the call compiled out the
	  linker does strip the rest, and that 26456 is byte for byte what
	  the sample measured before the default existed. The inherited
	  description then writes nothing, and %@ on a class without its
	  own description produces an empty field again, which is what this
	  option was added to fix (#354). That is the trade.

	  Host builds of the test corpora always have this on: it is
	  guarded on CONFIG_OBJZ, which only a Zephyr build defines.

config OBJZ_LOG_BUFFER_SIZE
	int "OZLog line buffer size (bytes)"
	range 32 1024
	default 128
	help
	  Size of the buffer OZLog formats one whole line into, the last
	  byte of which is the terminating NUL.

	  It is an automatic array in OZLog's own frame, so it is spent
	  on the stack of whatever thread calls OZLog -- and on every
	  such thread, not once. Raising it raises the high-water mark
	  of each of them by the same amount, which is what the ceiling
	  is about: 1024 is the whole of CONFIG_MAIN_STACK_SIZE's
	  default on mps2/an385, so a value near it needs the stack
	  raised first. Read the headroom with `kernel thread stacks` at
	  the shell rather than reasoning about it -- that is how the
	  sizes in px-keyboard's prj.conf were chosen.

	  Too small does not overflow and does not fault. OZLog stops
	  writing at the boundary, so a longer line is silently
	  truncated and it is the tail that goes: the last fields of
	  the line disappear, and a %@ that straddles the boundary lands
	  mid-description, because -getDescription:maxLength: is handed
	  only the bytes that are left and writes what fits. That is the
	  same silent-truncation contract that selector has everywhere
	  else, reached here through the buffer rather than through
	  %.N@. Nothing reports it, so a field that has gone missing
	  from a log line is the symptom to recognise.

	  Raise it for a program that logs a deep object graph -- an
	  OZArray or OZDictionary description prints its elements, so
	  its length is a property of the data rather than of the source
	  -- and lower it for one whose lines are short and whose stack
	  is tight.

	  The floor is 32 because below it not even one field fits
	  whole: a single conversion is rendered through a 32-byte
	  scratch buffer before being copied in, and the inherited
	  <ClassName: 0xADDRESS> description runs to strlen(name) + 14
	  bytes at most -- the brackets, ": ", "0x" and up to eight hex
	  digits, leading zeroes skipped -- so 22 for OZObject at any
	  real 32-bit address.

	  The default 128 is what src/OZLog.c hardcoded behind an
	  #ifndef until #420, which documented this option in OZLog.h
	  while declaring it nowhere. Setting it did not quietly do
	  nothing: Zephyr aborts on Kconfig warnings, so a prj.conf that
	  believed the documentation failed the configure step with
	  "attempt to assign the value '256' to the undefined symbol
	  OBJZ_LOG_BUFFER_SIZE" -- naming the user's spelling, not the
	  documentation that was wrong.

	  There is no #ifndef fallback left. src/OZLog.c is added to a
	  build only by oz2c.cmake under CONFIG_OBJZ and this
	  option lives inside `if OBJZ`, so the symbol always exists
	  where the file does -- and losing this entry is a compile
	  error at the buffer's declaration rather than a silent return
	  to 128. The fallback was the concealment, not a safety net.

config OBJZ_HEAP
	bool "Enable heap-based allocation (dynamicAllocWithHeap:)"
	depends on HEAP_MEM_POOL_SIZE > 0
	select SYS_HEAP_RUNTIME_STATS
	help
	  Allow objects to be allocated from an OZHeap instead of
	  k_mem_slab.  Adds +dynamicAllocWithHeap: class method and
	  heap-aware free path using CONTAINER_OF.
	  Enables SYS_HEAP_RUNTIME_STATS for heap usage queries.

endif # OBJZ
```

## west.yml
```
manifest:
  remotes:
    - name: zephyrproject-rtos
      url-base: https://github.com/zephyrproject-rtos

  projects:
    # Pinned, not `main`. CI runs `west init -l .` against this file, so an
    # unpinned revision meant every run built against whatever upstream main
    # was that morning -- a red build could be someone else's commit, and a
    # green one said nothing reproducible. v4.4.2 is what the samples are
    # tested against; cmsis and cmsis_6 are the same revisions main carried,
    # so the pin changes the kernel and nothing else here.
    - name: zephyr
      remote: zephyrproject-rtos
      revision: v4.4.2
      import:
        name-allowlist:
          - cmsis
          - cmsis_6

  self:
    path: objective-z
```

## prj.conf
```kconfig
CONFIG_STACK_USAGE=y
CONFIG_SHELL=y
CONFIG_ZEPHYR_OBJECTIVE_C=y
CONFIG_HEAP_MEM_POOL_SIZE=4096
CONFIG_STATIC_INIT_GNU=y
```

## src/OZLog.c
```c
/*
 * Copyright (c) 2025 Rodrigo Peixoto <rodrigopex@gmail.com>
 * SPDX-License-Identifier: Apache-2.0
 */

/**
 * @file OZLog.c
 * @brief Formatted logging with %@ object specifier for transpiled code.
 *
 * Pure C implementation of OZLog() for transpiled builds.
 * Uses OZ_PROTOCOL_SEND_getDescription_maxLength_() for %@ (const vtable dispatch).
 * Zero heap allocation — everything on the stack.
 */
#include <stdarg.h>
#include <zephyr/sys/printk.h>

#include "oz_dispatch.h"
#include "OZObject_ozh.h"

/* CONFIG_OBJZ_LOG_BUFFER_SIZE is a Kconfig option (int, range 32 1024,
 * default 128) and has no #ifndef fallback on purpose: a fallback is what
 * let it be documented and undeclared for as long as it was (#420). */

static int _oz_active_precision = -1;

int oz_log_precision(void)
{
	return _oz_active_precision;
}

void OZLog(const char *fmt, ...)
{
	char buf[CONFIG_OBJZ_LOG_BUFFER_SIZE];
	va_list args;
	int pos = 0;
	const int max = (int)sizeof(buf) - 1;

	va_start(args, fmt);

	const char *p = fmt;
	while (*p && pos < max) {
		if (*p != '%') {
			buf[pos++] = *p++;
			continue;
		}

		p++; /* skip '%' */
		if (*p == '\0') {
			break;
		}

		/* %% → literal '%' */
		if (*p == '%') {
			buf[pos++] = '%';
			p++;
			continue;
		}

		/* %@ or %.N@ → object description (optional precision) */
		{
			int obj_prec = -1;
			const char *saved = p;

			if (*p == '.' && p[1] >= '0' && p[1] <= '9') {
				p++;
				obj_prec = 0;
				while (*p >= '0' && *p <= '9') {
					obj_prec = obj_prec * 10 + (*p - '0');
					p++;
				}
			}

			if (*p == '@') {
				struct OZObject *obj = va_arg(args, struct OZObject *);
				if (obj == NULL) {
					const char *s = "(nil)";
					while (*s && pos < max) {
						buf[pos++] = *s++;
					}
				} else {
					_oz_active_precision = obj_prec;
					pos += OZ_PROTOCOL_SEND_getDescription_maxLength_(
						obj, buf + pos, max - pos);
					_oz_active_precision = -1;
				}
				p++;
				continue;
			}

			/* Not @, restore and fall through to regular specifier */
			p = saved;
		}

		/* Regular format specifier: collect into spec[] */
		char spec[32];
		int si = 0;
		spec[si++] = '%';

		/* Flags: -, +, space, #, 0 */
		while (*p == '-' || *p == '+' || *p == ' ' ||
		       *p == '#' || *p == '0') {
			if (si < (int)sizeof(spec) - 2) {
				spec[si++] = *p;
			}
			p++;
		}

		/* Width */
		while (*p >= '0' && *p <= '9') {
			if (si < (int)sizeof(spec) - 2) {
				spec[si++] = *p;
			}
			p++;
		}

		/* Precision */
		if (*p == '.') {
			if (si < (int)sizeof(spec) - 2) {
				spec[si++] = *p;
			}
			p++;
			while (*p >= '0' && *p <= '9') {
				if (si < (int)sizeof(spec) - 2) {
					spec[si++] = *p;
				}
				p++;
			}
		}

		/* Length modifier */
		int is_long = 0;
		int is_long_long = 0;
		if (*p == 'l') {
			if (si < (int)sizeof(spec) - 2) {
				spec[si++] = *p;
			}
			p++;
			is_long = 1;
			if (*p == 'l') {
				if (si < (int)sizeof(spec) - 2) {
					spec[si++] = *p;
				}
				p++;
				is_long_long = 1;
			}
		} else if (*p == 'h') {
			if (si < (int)sizeof(spec) - 2) {
				spec[si++] = *p;
			}
			p++;
			if (*p == 'h') {
				if (si < (int)sizeof(spec) - 2) {
					spec[si++] = *p;
				}
				p++;
			}
		} else if (*p == 'z') {
			if (si < (int)sizeof(spec) - 2) {
				spec[si++] = *p;
			}
			p++;
		}

		/* Conversion character */
		char conv = *p;
		if (si < (int)sizeof(spec) - 1) {
			spec[si++] = *p;
		}
		p++;
		spec[si] = '\0';

		char tmp[32];
		tmp[0] = '\0';

		switch (conv) {
		case 'd':
		case 'i':
			if (is_long_long) {
				snprintk(tmp, sizeof(tmp), spec,
					 va_arg(args, long long));
			} else if (is_long) {
				snprintk(tmp, sizeof(tmp), spec,
					 va_arg(args, long));
			} else {
				snprintk(tmp, sizeof(tmp), spec,
					 va_arg(args, int));
			}
			break;
		case 'u':
		case 'x':
		case 'X':
		case 'o':
			if (is_long_long) {
				snprintk(tmp, sizeof(tmp), spec,
					 va_arg(args, unsigned long long));
			} else if (is_long) {
				snprintk(tmp, sizeof(tmp), spec,
					 va_arg(args, unsigned long));
			} else {
				snprintk(tmp, sizeof(tmp), spec,
					 va_arg(args, unsigned int));
			}
			break;
		case 's': {
			const char *s = va_arg(args, const char *);
			snprintk(tmp, sizeof(tmp), "%s",
				 s ? s : "(null)");
			break;
		}
		case 'c':
			snprintk(tmp, sizeof(tmp), spec,
				 va_arg(args, int));
			break;
		case 'p':
			snprintk(tmp, sizeof(tmp), spec,
				 va_arg(args, void *));
			break;
		default:
			break;
		}

		const char *t = tmp;
		while (*t && pos < max) {
			buf[pos++] = *t++;
		}
	}

	buf[pos] = '\0';
	va_end(args);

	printk("%s\n", buf);
}
```
