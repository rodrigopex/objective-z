## objc/Kconfig
```kconfig
config OBJZ
    bool "Objective-C support"
    select STATIC_INIT_GNU
    select THREAD_LOCAL_STORAGE
    default n
    help
      Enable Objective-C language support in Zephyr.

      This option enables the Objective-C compiler and related tools,
      allowing you to write and compile Objective-C code within the Zephyr
      RTOS environment. Includes retain/release/autorelease memory
      management and per-thread autorelease pool stack.

      Note: Enabling Objective-C support may increase the size of the
      compiled binaries and could impact performance.

if OBJZ

config OBJZ_BOOT_BANNER
    bool "Objective-Z boot banner"
    default y
    help
      Print a boot banner at runtime initialization.
      The banner includes the module name and version number.

config OBJZ_BOOT_BANNER_STRING
    string "Boot banner string"
    depends on OBJZ_BOOT_BANNER
    default "Objective-Z Runtime"
    help
      The string printed in the boot banner. The version number
      is appended automatically.

config OBJZ_CYCLE_CHECK
    bool "Retain cycle detection at build time"
    default y
    help
      Detect retain cycles via tree-sitter analysis of @interface
      declarations. Fails the build if strong reference cycles are
      found between classes. Since __weak panics at runtime, this
      check prevents memory leaks that cannot be fixed at runtime.

config OBJZ_BLOCKS
    bool "Blocks (closures) support"
    default n
    help
      Enable Objective-C/C blocks runtime. Provides _Block_copy,
      _Block_release and related functions needed by Clang -fblocks.
      When enabled, .m files are compiled with -fblocks.

config OBJZ_STATIC_POOLS
    bool "Static allocation pools for ObjC classes"
    default n
    help
      Enable per-class static memory pools using K_MEM_SLAB.
      Use OZ_DEFINE_POOL(ClassName, block_size, count, align)
      in application code to declare pools. Classes without a
      pool fall back to the sys_heap allocator.

config OBJZ_STATIC_POOL_TABLE_SIZE
    int "Maximum number of static pool registrations"
    depends on OBJZ_STATIC_POOLS
    default 0
    help
      Maximum number of OZ_DEFINE_POOL registrations.
      0 = auto-computed from AST analysis.

config OBJZ_COLLECTIONS
    bool "Foundation collection classes (OZArray, OZDictionary)"
    help
      Enable OZArray and OZDictionary with NSFastEnumeration.

config OBJZ_NUMBERS
    bool "Foundation number class (OZNumber)"
    help
      Enable OZNumber for boxed numeric values.

config OBJZ_LITERALS
    bool "ObjC boxed literals and collection literals"
    depends on OBJZ_COLLECTIONS && OBJZ_NUMBERS
    help
      Enable @42, @YES, @3.14, @[...], and @{k:v} literal syntax.
      Requires both collection and number classes.

config OBJZ_LOG_BUFFER_SIZE
    int "OZLog format buffer size"
    default 128
    help
      Size of the stack buffer used by OZLog() for formatting.
      Messages longer than this are truncated.

config OBJZ_MEM_POOL_SIZE
    int "Objective-Z memory heap pool size"
    default 4096

config OBJZ_MEMORY_POOL_CUSTOM_SECTION
    bool "Objective-Z heap memory custom section"

config OBJZ_MEMORY_POOL_ZEPHYR_REGION
    bool "Objective-Z heap memory region"

config OBJZ_MEMORY_POOL_ZEPHYR_REGION_NAME
    string "Objective-Z heap memory region name"

config OBJZ_CLASS_TABLE_SIZE
    int "Class table size"
    default 0
    help
      Maximum number of Objective-C classes that can be registered.
      0 = auto-computed from AST analysis.

config OBJZ_CATEGORY_TABLE_SIZE
    int "Category table size"
    default 0
    help
      Maximum number of Objective-C categories that can be registered.
      0 = auto-computed from AST analysis.

config OBJZ_PROTOCOL_TABLE_SIZE
    int "Protocol table size"
    default 0
    help
      Maximum number of Objective-C protocols that can be registered.
      0 = auto-computed from AST analysis.

config OBJZ_HASH_TABLE_SIZE
    int "Method hash table size"
    default 0
    help
      Size of the global method hash table. Uses open addressing
      for collision resolution.
      0 = auto-computed from AST analysis.

config OBJZ_FLAT_DISPATCH
    bool "Global flat dispatch table"
    default y
    help
      Enable a single global flat dispatch table for O(1) method
      lookup via (class_id << SEL_BITS) | sel_id. Inheritance is
      flattened at init time (parent rows copied to children).
      Deterministic timing, no superclass chain walk.

config OBJZ_FLAT_DISPATCH_MAX_BYTES
    int "Maximum flat dispatch table size in bytes"
    depends on OBJZ_FLAT_DISPATCH
    default 8192
    help
      Upper bound for the flat dispatch table BSS allocation.
      Build fails if the auto-computed table exceeds this limit.

module = OBJZ
module-str = objz
source "subsys/logging/Kconfig.template.log_config"

endif
```

## samples/blocks_demo/sample.yaml
```yaml
sample:
  description: Blocks (closures) demo
  name: ObjZ Blocks Demo
common:
  tags: objz
  integration_platforms:
    - mps2/an385
  harness: console
  harness_config:
    type: multi_line
    ordered: true
    regex:
      - "=== Blocks Demo ==="
      - "Global block: 42"
      - "Capturing block: 99"
      - "Mutated counter: 3"
      - "Nested block: 77"
      - "=== Blocks Demo Complete ==="
tests:
  sample.objz.blocks_demo:
    tags: objz blocks
```

## samples/generics_demo/sample.yaml
```yaml
sample:
  description: Lightweight generics demo
  name: ObjZ Generics Demo
common:
  tags: objz
  integration_platforms:
    - mps2/an385
  harness: console
  harness_config:
    type: multi_line
    ordered: true
    regex:
      - "=== Generics Demo ==="
      - "numbers\\[0\\] = 10"
      - "numbers count = 3"
      - "name: Zephyr"
      - "name: Objective-Z"
      - "name: RTOS"
      - "alpha score = 100"
      - "sum = 60"
      - "generic\\[0\\] = Zephyr"
      - "matrix\\[0\\]\\[1\\] = 2"
      - "=== Generics Demo Complete ==="
tests:
  sample.objz.generics_demo:
    tags: objz generics
```

## samples/heap_alloc/sample.yaml
```yaml
sample:
  description: Heap-based allocation with allocWithHeap
  name: ObjZ Heap Alloc Demo
common:
  tags: objz
  platform_allow:
    - mps2/an385
  integration_platforms:
    - mps2/an385
  harness: console
  harness_config:
    type: multi_line
    ordered: true
    regex:
      - "App heap initialized"
      - "Local heap initialized"
      - "=== Heap Allocation Demo ==="
      - "app heap before: 0 bytes used"
      - "local heap before: 0 bytes used"
      - "Sensor allocated from app heap, value=42"
      - "app heap after alloc:.*bytes used"
      - "Sensor allocated from local heap, value=84"
      - "local heap after alloc:.*bytes used"
      - "Sensor dealloc.*42"
      - "Sensor dealloc.*84"
      - "app heap after free: 0 bytes used"
      - "local heap after free: 0 bytes used"
      - "Sensor allocated from system heap, value=99"
      - "Sensor dealloc.*99"
      - "Slab sensor value=7"
      - "Sensor dealloc.*7"
      - "=== Demo complete ==="
tests:
  sample.objz.heap_alloc:
    tags: objz heap
```

## samples/hello_world/sample.yaml
```yaml
sample:
  description: Basic class and instance method dispatch
  name: ObjZ Hello World
common:
  tags: objz
  integration_platforms:
    - mps2/an385
  harness: console
  harness_config:
    type: multi_line
    ordered: true
    regex:
      - "Hello, world from class"
      - "Hello, world from object"
tests:
  sample.objz.hello_world:
    tags: objz introduction
```

## samples/literals_demo/sample.yaml
```yaml
sample:
  description: ObjC boxed literals and collection literals demo
  name: ObjZ Literals Demo
common:
  tags: objz
  integration_platforms:
    - mps2/an385
  harness: console
  harness_config:
    type: multi_line
    ordered: true
    regex:
      - "=== ObjC Literals Demo ==="
      - "@YES = 1"
      - "@NO  = 0"
      - "@0  = 0"
      - "@15 = 15"
      - "@1000 = 1000"
      - "@3.14 = 3.14"
      - "array = \\(hello, 42\\)"
      - "arr\\[0\\] = hello"
      - "arr\\[1\\] = 42"
      - "dict = \\{key = value\\}"
      - "dict\\[@\"key\"\\] = value"
      - "=== Demo complete ==="
tests:
  sample.objz.literals_demo:
    tags: objz literals
```

## samples/mem_demo/sample.yaml
```yaml
sample:
  description: ARC memory management demo
  name: ObjZ Memory Management Demo
common:
  tags: objz
  integration_platforms:
    - mps2/an385
  harness: console
  harness_config:
    type: multi_line
    ordered: true
    regex:
      - "=== ARC Memory Management Demo ==="
      - "rc after alloc: 1"
      - "Sensor dealloc"
      - "=== Autorelease pool test ==="
      - "Sensor dealloc"
      - "=== Demo complete ==="
tests:
  sample.objz.mem_demo:
    tags: objz memory
```

## samples/transpiled_blocks/sample.yaml
```yaml
sample:
  description: Transpiled blocks (closures) demo
  name: Transpiled Blocks Demo
common:
  tags: transpiled blocks
  integration_platforms:
    - mps2/an385
    - qemu_riscv32
  harness: console
  harness_config:
    type: multi_line
    ordered: true
    regex:
      - "=== Blocks Demo ==="
      - "Global block: 42"
      - "Mutated counter: 3"
      - "Nested block: 77"
      - "Sensor sum: 90"
      - "=== Blocks Demo Complete ==="
tests:
  sample.transpiled_blocks:
    tags: transpiled blocks
```

## samples/transpiled_generics/sample.yaml
```yaml
sample:
  description: Transpiled generics demo with subscript, for-in, and blocks
  name: Transpiled Generics Demo
common:
  tags: transpiled generics
  integration_platforms:
    - mps2/an385
    - qemu_riscv32
  harness: console
  harness_config:
    type: multi_line
    ordered: true
    regex:
      - "=== Generics Demo ==="
      - "numbers\\[0\\] = 10"
      - "numbers count = 3"
      - "name: Zephyr"
      - "name: Objective-Z"
      - "name: RTOS"
      - "alpha score = 100"
      - "sum = 60"
      - "generic\\[0\\] = Zephyr"
      - "matrix\\[0\\]\\[1\\] = 2"
      - "=== Generics Demo Complete ==="
tests:
  sample.transpiled_generics:
    tags: transpiled generics
```

## samples/transpiled_led/sample.yaml
```yaml
sample:
  name: Transpiled LED Demo
  description: Pure C demo using OZ transpiler output (no ObjC runtime)
tests:
  sample.transpiled_led:
    tags: transpiled
    harness: console
    harness_config:
      type: one_line
      regex:
        - "Transpiled LED demo complete"
    platform_allow:
      - mps2/an385
      - qemu_riscv32
```

## samples/transpiled_literals/sample.yaml
```yaml
sample:
  description: Transpiled string, array, and dictionary literals demo
  name: Transpiled Literals Demo
common:
  tags: transpiled literals
  integration_platforms:
    - mps2/an385
    - qemu_riscv32
  harness: console
  harness_config:
    type: multi_line
    ordered: true
    regex:
      - "=== ObjC Literals Demo ==="
      - "greeting = hello"
      - "array = \\(hello, world\\)"
      - "arr\\[0\\] = hello"
      - "arr\\[1\\] = world"
      - "dict = \\{key = value\\}"
      - "dict\\[@\"key\"\\] = value"
      - "=== Demo complete ==="
tests:
  sample.transpiled_literals:
    tags: transpiled literals
```

## tests/objc-reference/oz/dictionary/testcase.yaml
```yaml
tests:
  test.oz.dictionary:
    tags:
      - objz
    integration_platforms:
      - mps2/an385
      - qemu_riscv32
```

## tests/objc-reference/oz/mutable_string/testcase.yaml
```yaml
tests:
  test.oz.mutable_string:
    tags:
      - objz
    integration_platforms:
      - mps2/an385
      - qemu_riscv32
```

## tests/objc-reference/oz/number/testcase.yaml
```yaml
tests:
  test.oz.number:
    tags:
      - objz
    integration_platforms:
      - mps2/an385
      - qemu_riscv32
```

## tests/objc-reference/runtime/arc_intensive/testcase.yaml
```yaml
tests:
  test.objz.arc_intensive:
    tags:
      - objz
    # RVO subtestsuite requires ARM Thumb-2 mov r7,r7 marker
    platform_allow:
      - mps2/an385
    integration_platforms:
      - mps2/an385
```

## tests/objc-reference/runtime/blocks/testcase.yaml
```yaml
tests:
  test.objz.blocks:
    tags:
      - objz
    integration_platforms:
      - mps2/an385
      - qemu_riscv32
```

## tests/objc-reference/runtime/flat_dispatch/testcase.yaml
```yaml
tests:
  test.objz.flat_dispatch:
    tags:
      - objz
    integration_platforms:
      - mps2/an385
      - qemu_riscv32
```

## tests/objc-reference/runtime/memory/testcase.yaml
```yaml
tests:
  test.objz.memory:
    tags:
      - objz
    integration_platforms:
      - mps2/an385
      - qemu_riscv32
```

## tests/objc-reference/runtime/static_pools/testcase.yaml
```yaml
tests:
  test.objz.static_pools:
    tags:
      - objz
    integration_platforms:
      - mps2/an385
      - qemu_riscv32
```

## tests/oz/array/testcase.yaml
```yaml
tests:
  test.oz.array:
    tags:
      - objz
    integration_platforms:
      - mps2/an385
```

## tests/oz/dictionary/testcase.yaml
```yaml
tests:
  test.oz.dictionary:
    tags:
      - objz
    integration_platforms:
      - mps2/an385
```

## tests/oz/mutable_string/testcase.yaml
```yaml
tests:
  test.oz.mutable_string:
    tags:
      - objz
    integration_platforms:
      - mps2/an385
```

## tests/oz/number/testcase.yaml
```yaml
tests:
  test.oz.number:
    tags:
      - objz
    integration_platforms:
      - mps2/an385
```

## tests/oz/string/testcase.yaml
```yaml
tests:
  test.oz.string:
    tags:
      - objz
    integration_platforms:
      - mps2/an385
      - qemu_riscv32
```

## tests/runtime/arc/testcase.yaml
```yaml
tests:
  test.objz.arc:
    tags:
      - objz
    integration_platforms:
      - mps2/an385
```
