## CMakeLists.txt
```
# SPDX-License-Identifier: Apache-2.0

cmake_minimum_required(VERSION 3.20.0)

set(ZEPHYR_EXTRA_MODULES "${CMAKE_CURRENT_SOURCE_DIR}/../../../")

find_package(Zephyr REQUIRED HINTS $ENV{ZEPHYR_BASE})
project(objc_mem_benchmark)

target_sources(app PRIVATE src/main.c)

objz_transpile_sources(app src/mem_helpers.m
    POOL_SIZES "MemBase=4,MemChild=24,MemGrandChild=24,OZSpinLock=2")
```

## sample.yaml
```
sample:
  description: Objective-Z memory allocation overhead
  name: ObjZ Memory Benchmark
common:
  tags: benchmark memory objz
  harness: console
  harness_config:
    type: one_line
    regex:
      - "PROJECT EXECUTION SUCCESSFUL"
tests:
  benchmark.memory.objz:
    tags: benchmark memory objz
```

## prj.conf
```kconfig
CONFIG_OBJZ=y
CONFIG_PRINTK=y

# Minimize jitter
CONFIG_TIMESLICING=n
CONFIG_PM=n

# Logging
CONFIG_LOG=y
CONFIG_LOG_MODE_MINIMAL=y

# Stack size
CONFIG_MAIN_STACK_SIZE=4096
```

## src/main.c
```c
/*
 * Copyright (c) 2025 Rodrigo Peixoto <rodrigopex@gmail.com>
 * SPDX-License-Identifier: Apache-2.0
 *
 * Memory Benchmark: Objective-Z (transpiler)
 *
 * All ObjC allocations go through per-class k_mem_slab pools
 * generated by the transpiler. Block size = sizeof(struct),
 * so there is zero allocator overhead per object.
 */

#include <zephyr/kernel.h>
#include <zephyr/sys/printk.h>
#include <platform/oz_platform.h>

/* Transpiler-generated headers */
#include "oz_dispatch.h"
#include "OZObject_ozh.h"
#include "OZString_ozh.h"
#include "OZNumber_ozh.h"
#include "OZArray_ozh.h"
#include "OZDictionary_ozh.h"
#include "OZSpinLock_ozh.h"
#include "mem_helpers_ozh.h"
#include "MemChild_ozh.h"
#include "MemGrandChild_ozh.h"

#define N_BULK 20

/* ── Benchmark sections ───────────────────────────────────────── */

static void bench_object_sizes(void)
{
	printk("-- Object Sizes (sizeof struct) --\n");
	printk("  %-40s: %4zu bytes\n", "OZObject (class_id + refcount)",
	       sizeof(struct OZObject));
	printk("  %-40s: %4zu bytes\n", "MemBase (OZObject, no ivars)",
	       sizeof(struct MemBase));
	printk("  %-40s: %4zu bytes\n", "MemChild (MemBase + 1 int)",
	       sizeof(struct MemChild));
	printk("  %-40s: %4zu bytes\n", "MemGrandChild (MemChild + 1 int)",
	       sizeof(struct MemGrandChild));
	printk("  %-40s: %4zu bytes\n", "Pointer size (struct OZObject *)",
	       sizeof(struct OZObject *));
	printk("  %-40s: %4s\n", "Dispatch mechanism",
	       "class_id enum (4 bytes) + vtable array");
	printk("  %-40s: %4s\n", "Refcount",
	       "inline oz_atomic_t (4 bytes)");
}

static void bench_single_alloc(void)
{
	printk("\n-- Single Allocation (slab, zero overhead) --\n");
	printk("  %-40s: %4zu bytes (slab block = sizeof)\n",
	       "MemBase object", sizeof(struct MemBase));
	printk("  %-40s: %4zu bytes (slab block = sizeof)\n",
	       "MemChild object", sizeof(struct MemChild));
	printk("  %-40s: %4zu bytes (slab block = sizeof)\n",
	       "MemGrandChild object", sizeof(struct MemGrandChild));
}

static void bench_bulk_alloc(void)
{
	printk("\n-- Bulk Allocation (%d objects, slab) --\n", N_BULK);
	printk("  %-40s: %4zu bytes (%zu bytes/obj)\n",
	       "20x MemChild total",
	       (size_t)(N_BULK * sizeof(struct MemChild)),
	       sizeof(struct MemChild));
	printk("  %-40s: %4zu bytes (%zu bytes/obj)\n",
	       "20x MemGrandChild total",
	       (size_t)(N_BULK * sizeof(struct MemGrandChild)),
	       sizeof(struct MemGrandChild));
}

static void bench_arc_overhead(void)
{
	printk("\n-- ARC / Reference Counting --\n");
	printk("  %-40s: %4zu bytes (inline in OZObject)\n",
	       "Refcount overhead (oz_atomic_t)",
	       sizeof(oz_atomic_t));
	printk("  %-40s:    0 bytes\n",
	       "Control block (none, refcount is inline)");
	printk("  %-40s:    0 bytes\n",
	       "ARC extra per-object cost (compile-time ARC)");
}

static void bench_foundation_sizes(void)
{
	printk("\n-- Foundation Class Sizes --\n");
	printk("  %-40s: %4zu bytes\n", "OZString",
	       sizeof(struct OZString));
	printk("  %-40s: %4zu bytes\n", "OZNumber",
	       sizeof(struct OZNumber));
	printk("  %-40s: %4zu bytes\n", "OZArray",
	       sizeof(struct OZArray));
	printk("  %-40s: %4zu bytes\n", "OZDictionary",
	       sizeof(struct OZDictionary));
	printk("  %-40s: %4zu bytes\n", "OZSpinLock",
	       sizeof(struct OZSpinLock));
}

/* ── Main ─────────────────────────────────────────────────────── */

int main(void)
{
	printk("=== Memory Benchmark: Objective-Z (transpiler) ===\n\n");

	bench_object_sizes();
	bench_single_alloc();
	bench_bulk_alloc();
	bench_arc_overhead();
	bench_foundation_sizes();

	printk("\nPROJECT EXECUTION SUCCESSFUL\n");
	return 0;
}
```
