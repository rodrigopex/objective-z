## CMakeLists.txt
```
# SPDX-License-Identifier: Apache-2.0

cmake_minimum_required(VERSION 3.20.0)

find_package(Zephyr REQUIRED HINTS $ENV{ZEPHYR_BASE})
project(zig_mem_benchmark)

target_sources(app PRIVATE src/entry.c src/heap_shim.c)

include(${CMAKE_CURRENT_SOURCE_DIR}/../../cmake/ZigCompile.cmake)
zig_find_compiler()
zig_compile_sources(app src/main.zig)
```

## prj.conf
```kconfig
CONFIG_SYS_HEAP_RUNTIME_STATS=y
CONFIG_PRINTK=y
CONFIG_TIMESLICING=n
CONFIG_PM=n
CONFIG_MAIN_STACK_SIZE=8192
```

## src/entry.c
```c
/*
 * Copyright (c) 2025 Rodrigo Peixoto <rodrigopex@gmail.com>
 * SPDX-License-Identifier: Apache-2.0
 */

extern void zig_main(void);

int main(void)
{
	zig_main();
	return 0;
}
```

## src/heap_shim.c
```c
/*
 * Copyright (c) 2025 Rodrigo Peixoto <rodrigopex@gmail.com>
 * SPDX-License-Identifier: Apache-2.0
 *
 * Heap shim for Zig memory benchmark
 *
 * Provides a dedicated sys_heap instance with runtime stats.
 * Zig calls these via @cImport extern declarations.
 */

#include <zephyr/sys/sys_heap.h>
#include <stddef.h>
#include <stdint.h>

#define BENCH_HEAP_SIZE 8192

static char bench_heap_mem[BENCH_HEAP_SIZE] __aligned(8);
static struct sys_heap bench_heap;

void heap_shim_init(void)
{
	sys_heap_init(&bench_heap, bench_heap_mem, BENCH_HEAP_SIZE);
}

void *heap_shim_alloc(size_t size, size_t align)
{
	return sys_heap_aligned_alloc(&bench_heap, align, size);
}

void heap_shim_free(void *ptr)
{
	if (ptr) {
		sys_heap_free(&bench_heap, ptr);
	}
}

void heap_shim_stats(size_t *allocated, size_t *free_bytes, size_t *max_allocated)
{
	struct sys_memory_stats s;

	sys_heap_runtime_stats_get(&bench_heap, &s);
	*allocated = s.allocated_bytes;
	*free_bytes = s.free_bytes;
	*max_allocated = s.max_allocated_bytes;
}
```
