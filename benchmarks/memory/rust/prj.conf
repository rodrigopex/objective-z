## CMakeLists.txt
```
# SPDX-License-Identifier: Apache-2.0

cmake_minimum_required(VERSION 3.20.0)

find_package(Zephyr REQUIRED HINTS $ENV{ZEPHYR_BASE})
project(rust_mem_benchmark)

rust_cargo_application()

target_sources(app PRIVATE src/heap_shim.c)
```

## prj.conf
```kconfig
CONFIG_RUST=y
CONFIG_RUST_ALLOC=y
CONFIG_COMMON_LIBC_MALLOC_ARENA_SIZE=8192
CONFIG_SYS_HEAP_RUNTIME_STATS=y
CONFIG_PRINTK=y
CONFIG_TIMESLICING=n
CONFIG_PM=n
CONFIG_MAIN_STACK_SIZE=8192
```

## boards/mps2_an385.overlay
```dts
/*
 * Override LED/button compatible strings to prevent zephyr-lang-rust
 * code generator from matching gpio-leds/gpio-keys nodes.
 * Works around #gpio-cells = <1> incompatibility with GpioPin::new().
 * GPIO controllers and pinctrl remain intact.
 */

/ {
	leds {
		compatible = "gpio-leds-unused";
	};

	gpio_keys {
		compatible = "gpio-keys-unused";
	};
};
```

## src/heap_shim.c
```c
/*
 * Copyright (c) 2025 Rodrigo Peixoto <rodrigopex@gmail.com>
 * SPDX-License-Identifier: Apache-2.0
 *
 * Heap shim for Rust FFI
 *
 * Wraps a dedicated sys_heap instance as real C symbols so Rust
 * can implement a GlobalAlloc backed by it. Same pattern as
 * timing_shim.c but for heap operations.
 */

#include <zephyr/sys/sys_heap.h>
#include <zephyr/sys/printk.h>
#include <stddef.h>
#include <stdint.h>

#define BENCH_HEAP_SIZE 8192

static char bench_heap_mem[BENCH_HEAP_SIZE] __aligned(8);
static struct sys_heap bench_heap;

void heap_shim_init(void)
{
	sys_heap_init(&bench_heap, bench_heap_mem, BENCH_HEAP_SIZE);
}

void *heap_shim_alloc(size_t size, size_t align)
{
	return sys_heap_aligned_alloc(&bench_heap, align, size);
}

void heap_shim_free(void *ptr)
{
	if (ptr) {
		sys_heap_free(&bench_heap, ptr);
	}
}

void heap_shim_stats(size_t *allocated, size_t *free_bytes, size_t *max_allocated)
{
	struct sys_memory_stats s;

	sys_heap_runtime_stats_get(&bench_heap, &s);
	*allocated = s.allocated_bytes;
	*free_bytes = s.free_bytes;
	*max_allocated = s.max_allocated_bytes;
}
```
