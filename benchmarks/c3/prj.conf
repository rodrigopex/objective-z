## CMakeLists.txt
```
# SPDX-License-Identifier: Apache-2.0

cmake_minimum_required(VERSION 3.20.0)

find_package(Zephyr REQUIRED HINTS $ENV{ZEPHYR_BASE})
project(c3_benchmark)

target_sources(app PRIVATE src/entry.c src/timing_shim.c)

include(${CMAKE_CURRENT_SOURCE_DIR}/../cmake/C3Compile.cmake)
c3_find_compiler()
c3_compile_sources(app src/main.c3)
```

## prj.conf
```kconfig
CONFIG_TIMING_FUNCTIONS=y
CONFIG_TIMESLICING=n
CONFIG_PM=n
CONFIG_HEAP_MEM_POOL_SIZE=8192
CONFIG_PRINTK=y
CONFIG_MAIN_STACK_SIZE=8192
CONFIG_STATIC_INIT_GNU=y
```

## src/entry.c
```c
/*
 * Copyright (c) 2025 Rodrigo Peixoto <rodrigopex@gmail.com>
 * SPDX-License-Identifier: Apache-2.0
 */

extern void c3_main(void);

int main(void)
{
	c3_main();
	return 0;
}
```

## src/timing_shim.c
```c
/*
 * Copyright (c) 2025 Rodrigo Peixoto <rodrigopex@gmail.com>
 * SPDX-License-Identifier: Apache-2.0
 *
 * Timing shim for C3 FFI
 *
 * Only wraps Zephyr's static inline timing helpers that have no
 * real linker symbol. Real functions (timing_init, timing_start,
 * timing_stop, k_malloc, k_free, printk) are called directly
 * from C3 via extern fn.
 */
#include <zephyr/kernel.h>
#include <zephyr/timing/timing.h>
#include <stdint.h>

uint32_t timing_shim_counter_get(void)
{
	return (uint32_t)timing_counter_get();
}

uint64_t timing_shim_cycles_between(uint32_t start, uint32_t end)
{
	timing_t s = start;
	timing_t e = end;
	return timing_cycles_get(&s, &e);
}

uint64_t timing_shim_cycles_to_ns(uint64_t cycles)
{
	return timing_cycles_to_ns(cycles);
}
```
