## CMakeLists.txt
```
# SPDX-License-Identifier: Apache-2.0

cmake_minimum_required(VERSION 3.20.0)

find_package(Zephyr REQUIRED HINTS $ENV{ZEPHYR_BASE})
project(cpp_benchmark)

target_sources(app PRIVATE src/main.cpp)
```

## sample.yaml
```
sample:
  description: C++ virtual dispatch and lifecycle timing
  name: C++ Benchmark
common:
  tags: benchmark cpp
  harness: console
  harness_config:
    type: one_line
    regex:
      - "PROJECT EXECUTION SUCCESSFUL"
tests:
  benchmark.cpp.timing:
    tags: benchmark cpp
```

## prj.conf
```kconfig
CONFIG_CPP=y
CONFIG_STD_CPP17=y
CONFIG_SPEED_OPTIMIZATIONS=y
CONFIG_REQUIRES_FULL_LIBCPP=y
CONFIG_CPP_RTTI=y
CONFIG_CPP_EXCEPTIONS=n
CONFIG_TIMING_FUNCTIONS=y
CONFIG_TIMESLICING=n
CONFIG_PM=n
CONFIG_COMMON_LIBC_MALLOC_ARENA_SIZE=2048
CONFIG_PRINTK=y
CONFIG_MAIN_STACK_SIZE=4096
```

## src/main.cpp
```c
/*
 * Copyright (c) 2025 Rodrigo Peixoto <rodrigopex@gmail.com>
 * SPDX-License-Identifier: Apache-2.0
 *
 * C++ Comprehensive Benchmark (OZ-070)
 *
 * 7 sections mirroring OZ: Allocation, Dispatch, Lifecycle,
 * Refcount, Properties/Sync, Collections+Blocks, Introspection.
 *
 * Same timing methodology as OZ benchmark:
 * DWT-based, explicit loops, overhead calibration.
 */
#include <zephyr/kernel.h>
#include <zephyr/sys/printk.h>
#include <zephyr/timing/timing.h>

#include <atomic>
#include <functional>
#include <memory>
#include <typeinfo>
#include <cstring>

#include "bench_classes.hpp"

/* ── Iteration tiers (match OZ benchmark) ─────────────────────────── */

#define FAST_ITERATIONS  50000
#define ITERATIONS       10000
#define SLOW_ITERATIONS   1000

/* ── Timing helpers ───────────────────────────────────────────────── */

static uint64_t timing_overhead_cycles;

static void calibrate_timing_overhead(void)
{
        timing_t start, end;
        uint64_t total = 0;

        for (int i = 0; i < ITERATIONS; i++) {
                start = timing_counter_get();
                end = timing_counter_get();
                total += timing_cycles_get(&start, &end);
        }
        timing_overhead_cycles = total / ITERATIONS;
}

static void bench_report(const char *desc, uint64_t total, int n)
{
        uint64_t avg = total / n;

        if (avg > timing_overhead_cycles) {
                avg -= timing_overhead_cycles;
        }
        uint64_t ns = timing_cycles_to_ns(avg);

        printk("  %-48s: %5llu cycles , %5llu ns\n", desc,
               (unsigned long long)avg, (unsigned long long)ns);
}

/* ── C function baseline ──────────────────────────────────────────── */

static void c_nop(void *self)
{
        (void)self;
        __asm__ volatile("" ::: "memory");
}

static void (*c_nop_ptr)(void *) = c_nop;

/* ── Section 1: Allocation ────────────────────────────────────────── */

/* Slab for placement-new (mirrors OZ k_mem_slab) */
K_MEM_SLAB_DEFINE(bench_slab, sizeof(BenchBase), 8, sizeof(void *));

static void bench_allocation(void)
{
        printk("\n--- 1. Allocation ---\n");
        timing_t s, e;
        uint64_t total;

        /* Value type on stack (vs OZ slab alloc) */
        total = 0;
        for (int i = 0; i < SLOW_ITERATIONS; i++) {
                s = timing_counter_get();
                BenchBase obj;
                obj.nop();
                e = timing_counter_get();
                total += timing_cycles_get(&s, &e);
        }
        bench_report("Value type on stack (BenchBase)", total, SLOW_ITERATIONS);

        /* new/delete (heap, vs OZ heap alloc) */
        total = 0;
        for (int i = 0; i < SLOW_ITERATIONS; i++) {
                s = timing_counter_get();
                BenchBase *obj = new BenchBase();
                delete obj;
                e = timing_counter_get();
                total += timing_cycles_get(&s, &e);
        }
        bench_report("new/delete (heap)", total, SLOW_ITERATIONS);

        /* unique_ptr create/destroy */
        total = 0;
        for (int i = 0; i < SLOW_ITERATIONS; i++) {
                s = timing_counter_get();
                auto obj = std::make_unique<BenchBase>();
                e = timing_counter_get();
                total += timing_cycles_get(&s, &e);
        }
        bench_report("unique_ptr create/destroy", total, SLOW_ITERATIONS);
}

/* ── Section 2: Dispatch ──────────────────────────────────────────── */

static void bench_dispatch(void)
{
        printk("\n--- 2. Dispatch ---\n");
        timing_t s, e;
        uint64_t total;

        BenchBase *volatile base = new BenchBase();
        BenchBase *volatile child = new BenchChild();
        BenchBase *volatile gchild = new BenchGrandChild();

        /* C function pointer baseline */
        total = 0;
        for (int i = 0; i < FAST_ITERATIONS; i++) {
                s = timing_counter_get();
                c_nop_ptr(base);
                e = timing_counter_get();
                total += timing_cycles_get(&s, &e);
        }
        bench_report("C function pointer (baseline)", total, FAST_ITERATIONS);

        /* Direct (non-virtual) call baseline */
        total = 0;
        for (int i = 0; i < FAST_ITERATIONS; i++) {
                BenchBase *p = base;
                s = timing_counter_get();
                p->BenchBase::nop();
                e = timing_counter_get();
                total += timing_cycles_get(&s, &e);
        }
        bench_report("Direct call (non-virtual)", total, FAST_ITERATIONS);

        /* Static method */
        total = 0;
        for (int i = 0; i < FAST_ITERATIONS; i++) {
                s = timing_counter_get();
                BenchBase::classNop();
                e = timing_counter_get();
                total += timing_cycles_get(&s, &e);
        }
        bench_report("Static method call", total, FAST_ITERATIONS);

        /* Virtual dispatch at various depths */
        total = 0;
        for (int i = 0; i < ITERATIONS; i++) {
                BenchBase *p = base;
                s = timing_counter_get();
                p->nop();
                e = timing_counter_get();
                total += timing_cycles_get(&s, &e);
        }
        bench_report("Virtual dispatch (depth=0)", total, ITERATIONS);

        total = 0;
        for (int i = 0; i < ITERATIONS; i++) {
                BenchBase *p = child;
                s = timing_counter_get();
                p->nop();
                e = timing_counter_get();
                total += timing_cycles_get(&s, &e);
        }
        bench_report("Virtual dispatch (depth=1)", total, ITERATIONS);

        total = 0;
        for (int i = 0; i < ITERATIONS; i++) {
                BenchBase *p = gchild;
                s = timing_counter_get();
                p->nop();
                e = timing_counter_get();
                total += timing_cycles_get(&s, &e);
        }
        bench_report("Virtual dispatch (depth=2)", total, ITERATIONS);

        /* Non-capturing lambda (func ptr decay) */
        auto lambda = +[]() -> int {
                __asm__ volatile("" ::: "memory");
                return 0;
        };
        int (*volatile lptr)() = lambda;

        total = 0;
        for (int i = 0; i < FAST_ITERATIONS; i++) {
                s = timing_counter_get();
                (void)lptr();
                e = timing_counter_get();
                total += timing_cycles_get(&s, &e);
        }
        bench_report("Lambda (non-capturing, fn ptr decay)", total, FAST_ITERATIONS);

        /* std::function with capture */
        int capture_val = 42;
        std::function<int()> fn_cap = [capture_val]() -> int {
                __asm__ volatile("" ::: "memory");
                return capture_val;
        };
        std::function<int()> *volatile fn_ptr = &fn_cap;

        total = 0;
        for (int i = 0; i < ITERATIONS; i++) {
                s = timing_counter_get();
                (void)(*fn_ptr)();
                e = timing_counter_get();
                total += timing_cycles_get(&s, &e);
        }
        bench_report("std::function (int capture)", total, ITERATIONS);

        /* std::function copy + destroy */
        total = 0;
        for (int i = 0; i < SLOW_ITERATIONS; i++) {
                s = timing_counter_get();
                std::function<int()> fn_copy = *fn_ptr;
                (void)fn_copy();
                e = timing_counter_get();
                total += timing_cycles_get(&s, &e);
        }
        bench_report("std::function copy + destroy", total, SLOW_ITERATIONS);

        delete base;
        delete child;
        delete gchild;
}

/* ── Section 3: Object Lifecycle ──────────────────────────────────── */

static void bench_lifecycle(void)
{
        printk("\n--- 3. Object Lifecycle ---\n");
        timing_t s, e;
        uint64_t total;

        /* new/delete */
        total = 0;
        for (int i = 0; i < SLOW_ITERATIONS; i++) {
                s = timing_counter_get();
                BenchBase *obj = new BenchBase();
                delete obj;
                e = timing_counter_get();
                total += timing_cycles_get(&s, &e);
        }
        bench_report("new + delete", total, SLOW_ITERATIONS);

        /* placement new + slab (mirrors OZ slab alloc) */
        total = 0;
        for (int i = 0; i < SLOW_ITERATIONS; i++) {
                void *mem;
                s = timing_counter_get();
                k_mem_slab_alloc(&bench_slab, &mem, K_NO_WAIT);
                PooledObj *obj = new (mem) PooledObj();
                obj->~PooledObj();
                k_mem_slab_free(&bench_slab, mem);
                e = timing_counter_get();
                total += timing_cycles_get(&s, &e);
        }
        bench_report("placement new + slab + dtor + free", total, SLOW_ITERATIONS);

        /* unique_ptr */
        total = 0;
        for (int i = 0; i < SLOW_ITERATIONS; i++) {
                s = timing_counter_get();
                auto obj = std::make_unique<BenchBase>();
                e = timing_counter_get();
                total += timing_cycles_get(&s, &e);
        }
        bench_report("make_unique create/destroy", total, SLOW_ITERATIONS);
}

/* ── Section 4: Reference Counting ────────────────────────────────── */

static void bench_refcount(void)
{
        printk("\n--- 4. Reference Counting ---\n");
        timing_t s, e;
        uint64_t total;

        BenchBase *obj = new BenchBase();

        /* atomic increment (retain) */
        total = 0;
        for (int i = 0; i < ITERATIONS; i++) {
                s = timing_counter_get();
                obj->retain();
                e = timing_counter_get();
                total += timing_cycles_get(&s, &e);
        }
        bench_report("atomic inc (retain)", total, ITERATIONS);

        /* Balance accumulated retains */
        obj->refcount.fetch_sub(ITERATIONS, std::memory_order_relaxed);

        /* retain + release pair */
        total = 0;
        for (int i = 0; i < ITERATIONS; i++) {
                s = timing_counter_get();
                obj->retain();
                obj->refcount.fetch_sub(1, std::memory_order_acq_rel);
                e = timing_counter_get();
                total += timing_cycles_get(&s, &e);
        }
        bench_report("atomic inc + dec pair", total, ITERATIONS);

        /* shared_ptr copy (retain equivalent) */
        total = 0;
        for (int i = 0; i < SLOW_ITERATIONS; i++) {
                auto sp = std::make_shared<BenchBase>();
                s = timing_counter_get();
                auto sp2 = sp;
                e = timing_counter_get();
                total += timing_cycles_get(&s, &e);
        }
        bench_report("shared_ptr copy", total, SLOW_ITERATIONS);

        /* shared_ptr copy + reset */
        total = 0;
        for (int i = 0; i < SLOW_ITERATIONS; i++) {
                auto sp = std::make_shared<BenchBase>();
                s = timing_counter_get();
                auto sp2 = sp;
                sp2.reset();
                e = timing_counter_get();
                total += timing_cycles_get(&s, &e);
        }
        bench_report("shared_ptr copy + reset", total, SLOW_ITERATIONS);

        delete obj;
}

/* ── Section 5: Properties / Synchronization ──────────────────────── */

static void bench_properties_sync(void)
{
        printk("\n--- 5. Properties / Synchronization ---\n");
        timing_t s, e;
        uint64_t total;

        BenchBase *obj = new BenchBase();

        /* property get (nonatomic) */
        total = 0;
        for (int i = 0; i < FAST_ITERATIONS; i++) {
                s = timing_counter_get();
                (void)obj->value();
                e = timing_counter_get();
                total += timing_cycles_get(&s, &e);
        }
        bench_report("property get (nonatomic)", total, FAST_ITERATIONS);

        /* property set (nonatomic) */
        total = 0;
        for (int i = 0; i < FAST_ITERATIONS; i++) {
                s = timing_counter_get();
                obj->setValue(42);
                e = timing_counter_get();
                total += timing_cycles_get(&s, &e);
        }
        bench_report("property set (nonatomic)", total, FAST_ITERATIONS);

        /* property get (atomic, k_spinlock — same as OZ) */
        total = 0;
        for (int i = 0; i < ITERATIONS; i++) {
                s = timing_counter_get();
                (void)obj->atomicValue();
                e = timing_counter_get();
                total += timing_cycles_get(&s, &e);
        }
        bench_report("property get (atomic, k_spinlock)", total, ITERATIONS);

        /* property set (atomic, k_spinlock) */
        total = 0;
        for (int i = 0; i < ITERATIONS; i++) {
                s = timing_counter_get();
                obj->setAtomicValue(42);
                e = timing_counter_get();
                total += timing_cycles_get(&s, &e);
        }
        bench_report("property set (atomic, k_spinlock)", total, ITERATIONS);

        /* synchronized (k_spinlock, same primitive as OZ) */
        total = 0;
        for (int i = 0; i < ITERATIONS; i++) {
                s = timing_counter_get();
                obj->syncNop();
                e = timing_counter_get();
                total += timing_cycles_get(&s, &e);
        }
        bench_report("synchronized (k_spinlock)", total, ITERATIONS);

        delete obj;
}

/* ── Section 6: Collections + Blocks ──────────────────────────────── */

/* Slab for SimpleString (mirrors OZString slab pool) */
K_MEM_SLAB_DEFINE(string_slab, sizeof(SimpleString), 16, sizeof(void *));

static const char *str_data[10] = {
        "s0", "s1", "s2", "s3", "s4", "s5", "s6", "s7", "s8", "s9",
};

static void bench_collections_blocks(void)
{
        printk("\n--- 6. Collections + Blocks ---\n");
        timing_t s, e;
        uint64_t total;

        /* ── Value-based baseline ─── */

        /* Raw int32_t array sum (baseline — no objects) */
        int32_t raw_arr[10] = {0, 1, 2, 3, 4, 5, 6, 7, 8, 9};

        total = 0;
        for (int i = 0; i < FAST_ITERATIONS; i++) {
                s = timing_counter_get();
                volatile int32_t sum = 0;
                for (int j = 0; j < 10; j++) {
                        sum += raw_arr[j];
                }
                e = timing_counter_get();
                total += timing_cycles_get(&s, &e);
        }
        bench_report("Raw int32_t[] sum (10 elems, baseline)", total, FAST_ITERATIONS);

        /* ── Object array (fair OZArray<OZString> comparison) ─── */

        /* Create 10 SimpleString objects from slab */
        SimpleString *items[10];

        for (int i = 0; i < 10; i++) {
                void *mem;
                k_mem_slab_alloc(&string_slab, &mem, K_NO_WAIT);
                items[i] = new (mem) SimpleString(str_data[i], 2);
        }

        /* Random access + length() */
        total = 0;
        for (int i = 0; i < FAST_ITERATIONS; i++) {
                s = timing_counter_get();
                (void)items[5]->length();
                e = timing_counter_get();
                total += timing_cycles_get(&s, &e);
        }
        bench_report("SimpleString*[10] access + length()", total, FAST_ITERATIONS);

        /* Raw loop: index + virtual length() per element */
        total = 0;
        for (int i = 0; i < ITERATIONS; i++) {
                s = timing_counter_get();
                volatile unsigned int sum = 0;
                for (int j = 0; j < 10; j++) {
                        sum += items[j]->length();
                }
                e = timing_counter_get();
                total += timing_cycles_get(&s, &e);
        }
        bench_report("SimpleString*[10] loop + length()", total, ITERATIONS);

        /* Polymorphic iterator: virtual ++ and * + length() per element */
        StringArray str_arr(items, 10);

        total = 0;
        for (int i = 0; i < ITERATIONS; i++) {
                s = timing_counter_get();
                volatile unsigned int sum = 0;
                for (auto it = str_arr.begin(); it != str_arr.end(); ++it) {
                        sum += (*it)->length();
                }
                e = timing_counter_get();
                total += timing_cycles_get(&s, &e);
        }
        bench_report("StringArray iterator (virtual, length)", total, ITERATIONS);

        for (int i = 0; i < 10; i++) {
                items[i]->~SimpleString();
                k_mem_slab_free(&string_slab, items[i]);
        }

        /* ── Blocks (lambda / std::function, from Section 2) ─── */
        printk("  (lambda/std::function benchmarks in Section 2 Dispatch)\n");
}

/* ── Section 7: Introspection (RTTI) ──────────────────────────────── */

static void bench_introspection(void)
{
        printk("\n--- 7. Introspection (RTTI) ---\n");
        timing_t s, e;
        uint64_t total;

        BenchBase *volatile child_as_base = new BenchChild();
        BenchBase *volatile plain_base = new BenchBase();

        /* dynamic_cast hit */
        total = 0;
        for (int i = 0; i < ITERATIONS; i++) {
                BenchBase *p = child_as_base;
                s = timing_counter_get();
                volatile auto *r = dynamic_cast<BenchChild *>(p);
                (void)r;
                e = timing_counter_get();
                total += timing_cycles_get(&s, &e);
        }
        bench_report("dynamic_cast (hit)", total, ITERATIONS);

        /* dynamic_cast miss */
        total = 0;
        for (int i = 0; i < ITERATIONS; i++) {
                BenchBase *p = plain_base;
                s = timing_counter_get();
                volatile auto *r = dynamic_cast<BenchChild *>(p);
                (void)r;
                e = timing_counter_get();
                total += timing_cycles_get(&s, &e);
        }
        bench_report("dynamic_cast (miss)", total, ITERATIONS);

        /* typeid */
        total = 0;
        for (int i = 0; i < ITERATIONS; i++) {
                BenchBase *p = child_as_base;
                s = timing_counter_get();
                const auto &ti = typeid(*p);
                volatile const char *name = ti.name();
                (void)name;
                e = timing_counter_get();
                total += timing_cycles_get(&s, &e);
        }
        bench_report("typeid() + name()", total, ITERATIONS);

        delete child_as_base;
        delete plain_base;
}

/* ── Object Sizes ─────────────────────────────────────────────────── */

static void print_sizes(void)
{
        printk("\n--- Object Sizes ---\n");
        printk("  %-48s: %5zu bytes\n", "BenchBase (vptr + refcount + props + lock)",
               sizeof(BenchBase));
        printk("  %-48s: %5zu bytes\n", "BenchChild (BenchBase, no extra)",
               sizeof(BenchChild));
        printk("  %-48s: %5zu bytes\n", "BenchGrandChild",
               sizeof(BenchGrandChild));
        printk("  %-48s: %5zu bytes\n", "SimpleString (vptr + data + len)",
               sizeof(SimpleString));
        printk("  %-48s: %5zu bytes\n", "std::shared_ptr<BenchBase>",
               sizeof(std::shared_ptr<BenchBase>));
        printk("  %-48s: %5zu bytes\n", "std::unique_ptr<BenchBase>",
               sizeof(std::unique_ptr<BenchBase>));
        printk("  %-48s: %5zu bytes\n", "std::function<int()>",
               sizeof(std::function<int()>));
        printk("  %-48s: %5zu bytes\n", "k_spinlock",
               sizeof(struct k_spinlock));
        printk("  %-48s: %5zu bytes\n", "Pointer size",
               sizeof(void *));
        printk("  %-48s: %5s\n", "Dispatch mechanism",
               "vptr -> vtable -> function (2 indirection)");
}

/* ── Main ─────────────────────────────────────────────────────────── */

int main(void)
{
        printk("=== C++ Benchmark (OZ-070) ===\n");
        printk("Board: %s\n", CONFIG_BOARD);
        printk("Iterations: fast=%d, normal=%d, slow=%d\n",
               FAST_ITERATIONS, ITERATIONS, SLOW_ITERATIONS);

        timing_init();
        timing_start();

        calibrate_timing_overhead();
        printk("Timing overhead: %llu cycles\n",
               (unsigned long long)timing_overhead_cycles);

        bench_allocation();
        bench_dispatch();
        bench_lifecycle();
        bench_refcount();
        bench_properties_sync();
        bench_collections_blocks();
        bench_introspection();

        timing_stop();

        print_sizes();

        printk("\nPROJECT EXECUTION SUCCESSFUL\n");
        return 0;
}
```

## src/bench_classes.hpp
```c
/*
 * Copyright (c) 2025 Rodrigo Peixoto <rodrigopex@gmail.com>
 * SPDX-License-Identifier: Apache-2.0
 *
 * C++ Benchmark Class Hierarchy (OZ-070)
 *
 * Mirrors OZ BenchBase/BenchChild/BenchGrandChild for
 * apples-to-apples comparison of dispatch, lifecycle,
 * properties, synchronization, and reference counting.
 */
#ifndef BENCH_CLASSES_HPP
#define BENCH_CLASSES_HPP

#include <atomic>
#include <cstdint>
#include <zephyr/spinlock.h>

class BenchBase {
public:
	int x = 0;
	std::atomic<int> refcount{1};

	/* Property backing fields */
	int _value = 0;
	int _atomicValue = 0;
	struct k_spinlock _prop_lock;

	virtual ~BenchBase() = default;

	virtual void nop() { __asm__ volatile("" ::: "memory"); }

	virtual int getValue() { return x; }

	static void classNop() { __asm__ volatile("" ::: "memory"); }

	/* Property accessors (nonatomic — direct field access) */
	int value() const { return _value; }

	void setValue(int v) { _value = v; }

	/* Property accessors (atomic — k_spinlock guarded, same as OZ) */
	int atomicValue()
	{
		k_spinlock_key_t key = k_spin_lock(&_prop_lock);
		int val = _atomicValue;
		k_spin_unlock(&_prop_lock, key);
		return val;
	}

	void setAtomicValue(int v)
	{
		k_spinlock_key_t key = k_spin_lock(&_prop_lock);
		_atomicValue = v;
		k_spin_unlock(&_prop_lock, key);
	}

	/* @synchronized equivalent — k_spinlock (same primitive as OZ) */
	void syncNop()
	{
		k_spinlock_key_t key = k_spin_lock(&_prop_lock);
		__asm__ volatile("" ::: "memory");
		k_spin_unlock(&_prop_lock, key);
	}

	void retain() { refcount.fetch_add(1, std::memory_order_relaxed); }

	void release()
	{
		if (refcount.fetch_sub(1, std::memory_order_acq_rel) == 1) {
			delete this;
		}
	}
};

class BenchChild : public BenchBase {
};

class BenchGrandChild : public BenchChild {
};

/* For placement-new lifecycle test */
class PooledObj {
public:
	int x = 0;

	virtual ~PooledObj() = default;

	virtual void nop() { __asm__ volatile("" ::: "memory"); }
};

/*
 * SimpleString — mirrors OZString layout for fair collection comparison.
 * Stores const char * + length, with a virtual length() accessor.
 */
class SimpleString {
public:
	const char *_data;
	unsigned int _length;

	SimpleString(const char *s, unsigned int len) : _data(s), _length(len) {}

	virtual ~SimpleString() = default;

	virtual unsigned int length() { return _length; }
};

/*
 * Polymorphic container with standard C++ iterators.
 * Uses virtual begin()/end() + virtual operator++ and operator*
 * to match OZ's for-in overhead (vtable dispatch per step).
 *
 * OZ for-in: vtable dispatch on iter() + next() per element.
 * C++ range-for: vtable dispatch on operator++ and operator* per element.
 */
class IIterator {
public:
	virtual ~IIterator() = default;
	virtual IIterator &operator++() = 0;
	virtual SimpleString *operator*() const = 0;
	virtual bool operator!=(const IIterator &other) const = 0;
};

class StringArray {
public:
	class Iterator : public IIterator {
	public:
		SimpleString **ptr;

		explicit Iterator(SimpleString **p) : ptr(p) {}

		Iterator &operator++() override
		{
			++ptr;
			return *this;
		}

		SimpleString *operator*() const override { return *ptr; }

		bool operator!=(const IIterator &other) const override
		{
			return ptr != static_cast<const Iterator &>(other).ptr;
		}
	};

	SimpleString **items;
	int count;

	StringArray(SimpleString **items_, int count_)
		: items(items_), count(count_) {}

	Iterator begin() { return Iterator(items); }
	Iterator end() { return Iterator(items + count); }
};

#endif /* BENCH_CLASSES_HPP */
```
