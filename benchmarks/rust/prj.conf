## CMakeLists.txt
```
# SPDX-License-Identifier: Apache-2.0

cmake_minimum_required(VERSION 3.20.0)

find_package(Zephyr REQUIRED HINTS $ENV{ZEPHYR_BASE})
project(rust_benchmark)

rust_cargo_application()

target_sources(app PRIVATE src/timing_shim.c)
```

## prj.conf
```kconfig
CONFIG_RUST=y
CONFIG_RUST_ALLOC=y
CONFIG_TIMING_FUNCTIONS=y
CONFIG_TIMESLICING=n
CONFIG_PM=n
CONFIG_COMMON_LIBC_MALLOC_ARENA_SIZE=8192
CONFIG_PRINTK=y
CONFIG_MAIN_STACK_SIZE=8192
```

## src/timing_shim.c
```c
/*
 * Copyright (c) 2025 Rodrigo Peixoto <rodrigopex@gmail.com>
 * SPDX-License-Identifier: Apache-2.0
 *
 * Timing shim for Rust FFI
 *
 * Wraps Zephyr's static inline timing functions as real symbols
 * callable from Rust via extern "C".
 */
#include <zephyr/timing/timing.h>
#include <stdint.h>

void timing_shim_init(void)
{
        timing_init();
}

void timing_shim_start(void)
{
        timing_start();
}

void timing_shim_stop(void)
{
        timing_stop();
}

uint32_t timing_shim_counter_get(void)
{
        return (uint32_t)timing_counter_get();
}

uint64_t timing_shim_cycles_between(uint32_t start, uint32_t end)
{
        timing_t s = start;
        timing_t e = end;
        return timing_cycles_get(&s, &e);
}

uint64_t timing_shim_cycles_to_ns(uint64_t cycles)
{
        return timing_cycles_to_ns(cycles);
}
```
