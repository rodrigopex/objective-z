## CMakeLists.txt
```
# SPDX-License-Identifier: Apache-2.0

cmake_minimum_required(VERSION 3.20.0)

set(ZEPHYR_EXTRA_MODULES "${CMAKE_CURRENT_SOURCE_DIR}/../../")
find_package(Zephyr REQUIRED HINTS $ENV{ZEPHYR_BASE})
project(pool_demo)

objz_transpile_sources(app src/main.m)
```

## sample.yaml
```
sample:
  description: Transpiled pool demo with loop and scope-based release
  name: ObjZ Pool Demo
common:
  tags: objz
  integration_platforms:
    - mps2/an385
    - qemu_riscv32
  harness: console
  harness_config:
    type: multi_line
    ordered: true
    regex:
      - "=== Static Pool Demo ==="
      - "pool alloc sensor value=1"
      - "Sensor dealloc"
      - "pool alloc sensor value=2"
      - "Sensor dealloc"
      - "pool alloc sensor value=3"
      - "Sensor dealloc"
      - "=== Demo complete ==="
tests:
  sample.objz.pool_demo:
    tags: objz pool
```

## prj.conf
```kconfig
CONFIG_OBJZ=y
CONFIG_OBJZ_STATIC_POOLS=y
CONFIG_LOG=y
CONFIG_LOG_PRINTK=n
CONFIG_OBJZ_LOG_LEVEL_DBG=y
CONFIG_PRINTK=y
```

## src/pools.c
```c
/*
 * SPDX-License-Identifier: Apache-2.0
 *
 * Static pool definitions for the pool_demo sample.
 * Must be a .c file — OZ_DEFINE_POOL uses SYS_INIT which
 * generates C constructs incompatible with the ObjC parser.
 */
#include <objc/pool.h>

/*
 * Sensor instance size: isa (4) + _refcount (4) + _value (4) = 12 bytes.
 * Round to 16 for alignment. Pool holds 4 instances.
 */
OZ_DEFINE_POOL(Sensor, 16, 4, 4);
```
