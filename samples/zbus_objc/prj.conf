## CMakeLists.txt
```
# SPDX-License-Identifier: Apache-2.0
cmake_minimum_required(VERSION 3.20.0)

set(ZEPHYR_EXTRA_MODULES "${CMAKE_CURRENT_SOURCE_DIR}/../../")

find_package(Zephyr REQUIRED HINTS $ENV{ZEPHYR_BASE})

project(zbus_objc_sample)

target_include_directories(app PRIVATE include)

objz_transpile_sources(app
    src/Producer.m
    src/main.m
)

target_sources(app PRIVATE
    src/channels.c
    src/consumer.c
)
```

## sample.yaml
```
sample:
  description: Zbus integration with ObjC producer and C consumer
  name: ObjZ Zbus Demo
common:
  tags: objz
  platform_allow:
    - mps2/an385
    - qemu_riscv32
    - nrf52833dk/nrf52833
  integration_platforms:
    - mps2/an385
  harness: console
  harness_config:
    type: multi_line
    ordered: true
    regex:
      - "Accelerometer data x=\\d+,y=\\d+,z=\\d+"
      - "Producer: Received 10 acknowledgments from Consumer"
tests:
  sample.objz.zbus:
    tags: objz zbus
```

## prj.conf
```kconfig
CONFIG_STACK_USAGE=y
CONFIG_SHELL=y
CONFIG_OBJZ=y
CONFIG_TEST_RANDOM_GENERATOR=y
CONFIG_ZBUS=y
CONFIG_ZBUS_MSG_SUBSCRIBER=y

CONFIG_THREAD_STACK_INFO=y
CONFIG_INIT_STACKS=y
CONFIG_SYS_HEAP_RUNTIME_STATS=y
CONFIG_SYS_HEAP_INFO=y
```

## include/Producer.h
```c
#pragma once

#import <Foundation/OZObject.h>

@interface AccDataProducer: OZObject
@property(assign, nonatomic, getter=ackCount) int count;

- (void)sendData;

@end
```

## include/channels.h
```c
#pragma once

#include <zephyr/kernel.h>
#include <zephyr/zbus/zbus.h>

struct msg_acc_data {
	int x;
	int y;
	int z;
};

ZBUS_CHAN_DECLARE(chan_acc_data); /* Type: struct msg_acc_data */

struct msg_acc_data_consumed {
	int count;
};

ZBUS_CHAN_DECLARE(chan_acc_data_consumed); /* Type: struct msg_acc_data_ack */

struct msg_version {
	uint8_t major;
	uint8_t minor;
	uint8_t patch;
	const char *hardware_id;
};
ZBUS_CHAN_DECLARE(chan_version); /* Type: struct msg_acc_data_ack */
```

## src/channels.c
```c
#include "channels.h"

ZBUS_CHAN_DEFINE(chan_acc_data, struct msg_acc_data, NULL, NULL, ZBUS_OBSERVERS_EMPTY,
		 ZBUS_MSG_INIT(.x = 0, .y = 0, .z = 0));

ZBUS_CHAN_DEFINE(chan_acc_data_consumed, struct msg_acc_data_consumed, NULL, NULL,
		 ZBUS_OBSERVERS_EMPTY, ZBUS_MSG_INIT(.count = 0));

ZBUS_CHAN_DEFINE(chan_version, struct msg_version, NULL, NULL, ZBUS_OBSERVERS_EMPTY,
		 ZBUS_MSG_INIT(.major = 4, .minor = 7, .patch = 98, .hardware_id = "RPA9"));
```

## src/consumer.c
```c
/*
 * Copyright (c) 2025 Rodrigo Peixoto <rodrigopex@gmail.com>
 * SPDX-License-Identifier: Apache-2.0
 */

#include "channels.h"
#include "oz_dispatch.h"

ZBUS_MSG_SUBSCRIBER_DEFINE(msub_consumer);

ZBUS_CHAN_ADD_OBS(chan_acc_data, msub_consumer, 3);

void consumer_thread(void *p1, void *p2, void *p3)
{
	ARG_UNUSED(p1);
	ARG_UNUSED(p2);
	ARG_UNUSED(p3);

	const struct zbus_channel *chan;
	struct msg_acc_data msg;
	struct msg_acc_data_consumed ack_msg = {.count = 0};

	while (1) {
		zbus_sub_wait_msg(&msub_consumer, &chan, &msg, K_FOREVER);
		++ack_msg.count;

		OZLog(" %d - Accelerometer data x=%02d,y=%02d,z=%02d",
		      ack_msg.count, msg.x, msg.y, msg.z);

		zbus_chan_pub(&chan_acc_data_consumed, &ack_msg, K_MSEC(250));
	}
}

K_THREAD_DEFINE(consumer_thread_id, 4096, consumer_thread, NULL, NULL, NULL, 3,
		0, 0);
```
