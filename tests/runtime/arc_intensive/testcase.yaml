## tests/runtime/arc_intensive/testcase.yaml
```yaml
tests:
  test.objz.arc_intensive:
    tags:
      - objz
    integration_platforms:
      - mps2/an385
```

## tests/runtime/blocks/testcase.yaml
```yaml
tests:
  test.objz.blocks:
    tags:
      - objz
    integration_platforms:
      - mps2/an385
```

## tests/runtime/categories/testcase.yaml
```yaml
tests:
  test.objz.categories:
    tags:
      - objz
    integration_platforms:
      - mps2/an385
```

## tests/runtime/class_registry/testcase.yaml
```yaml
tests:
  test.objz.class_registry:
    tags:
      - objz
    integration_platforms:
      - mps2/an385
```

## tests/runtime/dispatch_cache/testcase.yaml
```yaml
tests:
  test.objz.dispatch_cache:
    tags:
      - objz
    integration_platforms:
      - mps2/an385
```

## tests/runtime/flat_dispatch/testcase.yaml
```yaml
tests:
  test.objz.flat_dispatch:
    tags:
      - objz
    integration_platforms:
      - mps2/an385
```

## tests/runtime/gpio/testcase.yaml
```yaml
tests:
  test.objz.gpio:
    tags:
      - objz
      - gpio
    platform_allow:
      - mps2/an385
    integration_platforms:
      - mps2/an385
```

## tests/runtime/hash_table/testcase.yaml
```yaml
tests:
  test.objz.hash_table:
    tags:
      - objz
    integration_platforms:
      - mps2/an385
      - qemu_riscv32
```

## tests/runtime/literals/testcase.yaml
```yaml
tests:
  test.objz.literals:
    tags:
      - objz
    integration_platforms:
      - mps2/an385
```

## tests/runtime/memory/testcase.yaml
```yaml
tests:
  test.objz.memory:
    tags:
      - objz
    integration_platforms:
      - mps2/an385
```

## tests/runtime/message_dispatch/testcase.yaml
```yaml
tests:
  test.objz.message_dispatch:
    tags:
      - objz
    integration_platforms:
      - mps2/an385
```

## tests/runtime/mutable_string/testcase.yaml
```yaml
tests:
  test.objz.mutable_string:
    tags:
      - objz
    integration_platforms:
      - mps2/an385
```

## tests/runtime/protocols/testcase.yaml
```yaml
tests:
  test.objz.protocols:
    tags:
      - objz
    integration_platforms:
      - mps2/an385
```

## tests/runtime/refcount/testcase.yaml
```yaml
tests:
  test.objz.refcount:
    tags:
      - objz
    integration_platforms:
      - mps2/an385
```

## tests/runtime/static_pools/testcase.yaml
```yaml
tests:
  test.objz.static_pools:
    tags:
      - objz
    integration_platforms:
      - mps2/an385
```

## tests/zephyr/testcase.yaml
```yaml
tests:
  oz.transpiler.zephyr:
    platform_allow:
      - native_sim
      - mps2/an385
    tags: oz transpiler
    timeout: 60
```
