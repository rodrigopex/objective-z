## CMakeLists.txt
```
# SPDX-License-Identifier: Apache-2.0
cmake_minimum_required(VERSION 3.20.0)

set(ZEPHYR_EXTRA_MODULES "${CMAKE_CURRENT_SOURCE_DIR}/../../../objc/")

find_package(Zephyr REQUIRED HINTS $ENV{ZEPHYR_BASE})

project(test_static_pools)

FILE(GLOB app_sources src/*.c)
target_sources(app PRIVATE ${app_sources})

objz_target_sources(app src/helpers.m)
```

## prj.conf
```kconfig
CONFIG_ZTEST=y
CONFIG_OBJZ=y
CONFIG_OBJZ_STATIC_POOLS=y
CONFIG_OBJZ_MEM_POOL_SIZE=8192
```

## src/pools.c
```c
/*
 * Copyright (c) 2025 Rodrigo Peixoto <rodrigopex@gmail.com>
 * SPDX-License-Identifier: Apache-2.0
 */

/**
 * @file pools.c
 * @brief Pool definitions for static pool tests.
 *
 * OZ_DEFINE_POOL must be in a .c file (not .m) because it uses
 * Zephyr's K_MEM_SLAB_DEFINE and SYS_INIT macros.
 *
 * TestPooled : Object has: isa (4) + _refcount (4) + _tag (4) = 12 bytes.
 * We define 4 slots of 12 bytes each, 4-byte aligned.
 */
#include <objc/pool.h>

OZ_DEFINE_POOL(TestPooled, 12, 4, 4);
```
