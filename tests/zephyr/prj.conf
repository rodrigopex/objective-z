## CMakeLists.txt
```
# SPDX-License-Identifier: Apache-2.0
cmake_minimum_required(VERSION 3.20.0)
find_package(Zephyr REQUIRED HINTS $ENV{ZEPHYR_BASE})

project(oz_transpiler_zephyr_tests)

# PAL in Zephyr mode
target_compile_definitions(app PRIVATE OZ_PLATFORM_ZEPHYR)

# Include paths
target_include_directories(app PRIVATE
    ${CMAKE_CURRENT_SOURCE_DIR}/../../include    # platform/ headers
    ${CMAKE_CURRENT_SOURCE_DIR}/generated              # transpiled output
    ${CMAKE_CURRENT_SOURCE_DIR}/generated/Foundation   # Foundation classes
)

# Test sources
target_sources(app PRIVATE
    src/main.c
    src/test_lifecycle.c
    src/test_dispatch.c
    src/test_memory.c
    src/test_protocol.c
    src/test_boxed_expr.c
    src/test_census.c
    src/test_freed_slot.c
)

# The refcount instruments (#452), on for this suite as of #490.
#
# It has to be app-wide rather than scoped to `test_freed_slot.c`: the
# poison it measures is emitted into `_oz_free`, which lives in the
# generated sources below, so a per-file definition would compile the test
# against a `Node_oz_free` that stamps nothing.
#
# Turning them on also gives the traps their only on-target coverage --
# nothing else here defines the macro, so every line of #452's and #490's C
# was reaching a board for the first time through this. All existing cases
# pass with it on, verified on mps2/an385 and qemu_cortex_a53.
target_compile_definitions(app PRIVATE OZ_DEBUG_REFCOUNT)

# Transpiled class sources
file(GLOB GENERATED_SOURCES "generated/*.c" "generated/Foundation/*.c")
target_sources(app PRIVATE ${GENERATED_SOURCES})
```

## prj.conf
```kconfig
# Enable the Zephyr test framework
CONFIG_ZTEST=y

# Enough stack for tests
CONFIG_MAIN_STACK_SIZE=4096
CONFIG_ZTEST_STACK_SIZE=2048

# Static constructors (slab initialization via K_MEM_SLAB_DEFINE)
CONFIG_STATIC_INIT_GNU=y

# Log output (for OZLog / OZ_PLATFORM_PRINT)
CONFIG_PRINTK=y
```

## src/main.c
```c
/* SPDX-License-Identifier: Apache-2.0 */
/* All test suites register themselves via ZTEST_SUITE in their own files */
#include <zephyr/ztest.h>
```

## src/test_boxed_expr.c
```c
/* SPDX-License-Identifier: Apache-2.0 */
/* Boxed expression tests: @(variable), @(arithmetic), @(call), @(float), @(uint) */
#include <zephyr/ztest.h>
#include "BoxedTest_ozh.h"
#include "OZNumber_ozh.h"
#include "OZObject_ozh.h"

/* Decode Q31+shift to int32: raw >> (31 - shift) */
static inline int32_t q31_int32(struct OZNumber *n)
{
	if (n->_shift >= 31) {
		return n->_raw;
	}
	return n->_raw >> (31 - n->_shift);
}

/* Decode Q31+shift to float: raw / 2^(31-shift) */
static inline float q31_float(struct OZNumber *n)
{
	if (n->_shift >= 31) {
		return (float)n->_raw;
	}
	return (float)n->_raw / (float)(1UL << (31 - n->_shift));
}

ZTEST_SUITE(boxed_expr, NULL, NULL, NULL, NULL, NULL);

ZTEST(boxed_expr, test_boxed_variable_int)
{
	struct BoxedTest *bt = BoxedTest_alloc();
	zassert_not_null(bt, "BoxedTest alloc returned NULL");
	BoxedTest_run(bt);
	struct OZNumber *n = BoxedTest_fromVar(bt);
	zassert_not_null(n, "fromVar returned NULL");
	zassert_equal(7, q31_int32(n), "Expected 7");
	OZObject_release((struct OZObject *)bt);
}

ZTEST(boxed_expr, test_boxed_arithmetic)
{
	struct BoxedTest *bt = BoxedTest_alloc();
	zassert_not_null(bt, "BoxedTest alloc returned NULL");
	BoxedTest_run(bt);
	struct OZNumber *n = BoxedTest_fromExpr(bt);
	zassert_not_null(n, "fromExpr returned NULL");
	zassert_equal(10, q31_int32(n), "Expected 10");
	OZObject_release((struct OZObject *)bt);
}

ZTEST(boxed_expr, test_boxed_function_call)
{
	struct BoxedTest *bt = BoxedTest_alloc();
	zassert_not_null(bt, "BoxedTest alloc returned NULL");
	BoxedTest_run(bt);
	struct OZNumber *n = BoxedTest_fromCall(bt);
	zassert_not_null(n, "fromCall returned NULL");
	zassert_equal(21, q31_int32(n), "Expected 21");
	OZObject_release((struct OZObject *)bt);
}

ZTEST(boxed_expr, test_boxed_float)
{
	struct BoxedTest *bt = BoxedTest_alloc();
	zassert_not_null(bt, "BoxedTest alloc returned NULL");
	BoxedTest_run(bt);
	struct OZNumber *n = BoxedTest_fromFloat(bt);
	zassert_not_null(n, "fromFloat returned NULL");
	float val = q31_float(n);
	zassert_true(val > 2.4f && val < 2.6f, "Expected ~2.5f");
	OZObject_release((struct OZObject *)bt);
}

ZTEST(boxed_expr, test_boxed_unsigned_int)
{
	struct BoxedTest *bt = BoxedTest_alloc();
	zassert_not_null(bt, "BoxedTest alloc returned NULL");
	BoxedTest_run(bt);
	struct OZNumber *n = BoxedTest_fromUint(bt);
	zassert_not_null(n, "fromUint returned NULL");
	zassert_equal(1000u, (uint32_t)q31_int32(n), "Expected 1000");
	OZObject_release((struct OZObject *)bt);
}
```

## src/test_census.c
```c
/* SPDX-License-Identifier: Apache-2.0 */
/*
 * Census tests: the on-target half of the exit-time live-object census
 * (#451).
 *
 * On target this is the *only* leak instrument there is. `k_mem_slab` is
 * static memory, so an unreleased object is invisible by construction --
 * nothing is allocated from a system heap, nothing is unreachable, and no
 * sanitizer runs. Before this, no sample and no ztest queried
 * `k_mem_slab_num_used_get` at all, and the Zephyr PAL had neither
 * `oz_slab_outstanding_count` nor `oz_slab_check_leaks`; only the host
 * backend did, and there with zero call sites.
 *
 * The first two cases pin the two PAL accessors against a slab this file
 * owns, so they answer for themselves regardless of what the rest of the
 * suites did. The third asks the whole-program question the generated
 * `oz_check_all_slabs()` exists to answer, and is deliberately
 * order-independent: every other suite here balances its allocations, so
 * a non-zero answer is a real finding about one of them rather than a
 * side effect of which suite ran first.
 */
#include <zephyr/ztest.h>
#include "Widget_ozh.h"
#include "OZObject_ozh.h"
#include "oz_dispatch.h"

/* File scope, because on this backend OZ_SLAB_DEFINE is
 * K_MEM_SLAB_DEFINE and reserves static storage plus its own buffer. */
OZ_SLAB_DEFINE(census_slab, 32, 2, 4);

ZTEST_SUITE(census, NULL, NULL, NULL, NULL, NULL);

ZTEST(census, test_outstanding_count_follows_the_slab)
{
	void *a = NULL;

	zassert_equal(0u, oz_slab_outstanding_count(&census_slab));
	zassert_equal(OZ_OK, oz_slab_alloc(&census_slab, &a));
	zassert_equal(1u, oz_slab_outstanding_count(&census_slab));
	oz_slab_free(&census_slab, a);
	zassert_equal(0u, oz_slab_outstanding_count(&census_slab));
}

ZTEST(census, test_check_leaks_answers_both_ways)
{
	void *a = NULL;

	/* Absence first, then presence. A 0 on its own is also what an
	 * implementation that always returns 0 would say, so the clean
	 * answer is only worth having next to a dirty one. */
	zassert_equal(0, oz_slab_check_leaks(&census_slab, "census_slab"));

	zassert_equal(OZ_OK, oz_slab_alloc(&census_slab, &a));
	/* Prints `LEAK: census_slab has 1 outstanding allocation(s)` on the
	 * console. That line is this case's expected output. */
	zassert_equal(1, oz_slab_check_leaks(&census_slab, "census_slab"));

	oz_slab_free(&census_slab, a);
	zassert_equal(0, oz_slab_check_leaks(&census_slab, "census_slab"));
}

ZTEST(census, test_the_program_census_is_clean)
{
	/* Presence: this suite can make the census dirty, so the clean
	 * answer below is a measurement rather than a property of a census
	 * that cannot see anything. */
	struct Widget *w = Widget_alloc();

	zassert_not_null(w);
	zassert_equal(1, oz_check_all_slabs(),
		      "an outstanding Widget must be counted");

	OZObject_release((struct OZObject *)w);

	/* Absence: with it released, every slab in the program is empty. */
	zassert_equal(0, oz_check_all_slabs(),
		      "every slab block handed out must have been handed back");
}
```

## src/test_dispatch.c
```c
/* SPDX-License-Identifier: Apache-2.0 */
/* Dispatch tests: super calls, inheritance chain, method override */
#include <zephyr/ztest.h>
#include "Base_ozh.h"
#include "Child_ozh.h"
#include "Level1_ozh.h"
#include "Level3_ozh.h"
#include "Level4_ozh.h"
#include "OZObject_ozh.h"
#include "oz_dispatch.h"

ZTEST_SUITE(dispatch, NULL, NULL, NULL, NULL, NULL);

ZTEST(dispatch, test_super_calls_parent_init)
{
	struct Child *c = Child_alloc();
	OZ_PROTOCOL_SEND_init((struct OZObject *)c);

	/* Parent init sets baseVal=10, child init sets childVal=20 */
	zassert_equal(10, Base_baseVal((struct Base *)c),
		      "Expected baseVal=10 from super init");
	zassert_equal(20, Child_childVal(c),
		      "Expected childVal=20 from child init");

	OZObject_release((struct OZObject *)c);
}

ZTEST(dispatch, test_deep_inheritance_depth)
{
	struct Level4 *l4 = Level4_alloc();
	zassert_equal(4, Level4_depth(l4), "Level4 depth should be 4");
	OZObject_release((struct OZObject *)l4);

	struct Level1 *l1 = Level1_alloc();
	zassert_equal(1, Level1_depth(l1), "Level1 depth should be 1");
	OZObject_release((struct OZObject *)l1);
}

ZTEST(dispatch, test_protocol_dispatch_depth)
{
	struct Level3 *l3 = Level3_alloc();
	/* OZ_PROTOCOL_SEND_depth dispatches via const vtable */
	zassert_equal(3, OZ_PROTOCOL_SEND_depth((struct OZObject *)l3),
		      "Protocol dispatch: Level3 depth should be 3");
	OZObject_release((struct OZObject *)l3);
}
```

## src/test_freed_slot.c
```c
/* SPDX-License-Identifier: Apache-2.0 */
/*
 * What survives a `k_mem_slab_free`, measured on target (#490).
 *
 * This is the half of the freed-slot instruments that no host harness can
 * establish. `refcount_traps.rs` proves the trap fires and where it sits in
 * `oz_release`, by staging the sentinel on a live object -- fully defined,
 * and identical on every platform. What it cannot prove is that the
 * sentinel is still there to be read after the allocator has taken the
 * block back, because that is a fact about the allocator. On arm64 macOS it
 * is not: a 12-byte block read back `05 00 00 00 00 00 00 00 05 00 00 00`,
 * malloc's bookkeeping having taken the body as well as the header. So the
 * survival claim has to be measured where the allocator is `k_mem_slab`.
 *
 * Neither file is sufficient alone. This one would pass if the trap read
 * the marker and did nothing with it; that one would pass on a target where
 * the marker never survives at all.
 *
 * **Why the marker is the refcount and not the class id.** `_meta` is the
 * root struct's first member, so `class_id` sits at offset 0 --
 * and `k_mem_slab_free` links a freed block into its free list by writing
 * the link *into the block*, at offset 0:
 *
 *     *(char **) mem = slab->free_list;      kernel/mem_slab.c
 *
 * So the class stamp is destroyed by the free it exists to outlive. Every
 * bit of `_meta` is: `heap_allocated` is bit 10 of the link,
 * `deallocating` bit 11, `immortal` bit 12. `oz_refcount` begins at exactly
 * `sizeof(char *)`, the first word the link cannot reach, and structurally
 * rather than by luck -- `oz_atomic_t` is Zephyr's `atomic_t`, a `long`,
 * and `sizeof(long) == sizeof(char *)` on both ILP32 and LP64, so its
 * alignment rounds the offset up to precisely `sizeof(char *)`.
 *
 * Verified on both widths while this was written: mps2/an385 (offset 4) and
 * qemu_cortex_a53 (offset 8), the stamped word intact on both, the class id
 * clobbered on both (588 and 376 -- the low bits of the two links).
 *
 * The reads below are deliberately of a slot the slab owns. That is defined
 * here in a way it is not on a host: slab storage is a static array that
 * outlives every allocation, so the bytes exist and are stable; only the
 * right to use them has gone.
 */
#include <zephyr/ztest.h>
#include <stddef.h>
#include "Node_ozh.h"
#include "OZObject_ozh.h"
#include "oz_dispatch.h"

ZTEST_SUITE(freed_slot, NULL, NULL, NULL, NULL, NULL);

/* The layout that makes the marker reachable after the free. Asserted
 * separately from the survival below, because a reorder of the root struct
 * would break the survival with no hint as to why. */
ZTEST(freed_slot, test_the_refcount_starts_where_the_free_list_link_ends)
{
	zassert_equal(0u, offsetof(struct OZObject, _meta),
		      "_meta must be the root struct's first member -- the dispatch "
		      "header reads class_id through `struct oz_metadata *` on that "
		      "basis");
	zassert_equal(4u, sizeof(struct oz_metadata),
		      "the metadata is one 32-bit word of bitfields; a wider one would "
		      "put a live field under the free-list link on a 32-bit target");
	zassert_equal(sizeof(char *), offsetof(struct OZObject, oz_refcount),
		      "oz_refcount must begin exactly where k_mem_slab_free's link "
		      "ends. Below that and the marker is clobbered; above it and "
		      "there is padding no one asked for");
}

/* The measurement: allocate, release to zero so `Node_oz_free` runs, then
 * read the slot back.
 *
 * Presence and absence on the same slot, in that order. The absence half --
 * that `class_id` did *not* survive -- is only a finding next to a marker
 * that did; on its own it would also be what a `_oz_free` that stamped
 * nothing at all looks like.
 */
ZTEST(freed_slot, test_the_sentinel_survives_the_free_and_the_class_id_does_not)
{
	struct Node *n = Node_alloc();
	struct OZObject *o;

	zassert_not_null(n, "the Node slab must have a slot free");
	o = (struct OZObject *)n;
	zassert_equal(OZ_CLASS_Node, o->_meta.class_id,
		      "the live object must know its class, or nothing below is about "
		      "a poisoned slot");

	/* Refcount is 1 from the alloc, so this one release deallocates and
	 * calls Node_oz_free, which poisons and returns the slot. */
	OZObject_release(o);

	zassert_equal(OZ_REFCOUNT_FREED, oz_atomic_get(&o->oz_refcount),
		      "the freed sentinel must outlive k_mem_slab_free -- it is the "
		      "only marker on this backend that does, and oz_retain/oz_release "
		      "read it to name a use-after-free");
	zassert_not_equal(OZ_CLASS_ID_FREED, o->_meta.class_id,
		      "the class stamp is expected to be GONE: offset 0 is where the "
		      "free-list link goes. If this ever passes, k_mem_slab changed "
		      "and the sentinel may no longer be needed");
}

/* Reallocating the slot clears the sentinel, so the trap cannot fire on a
 * legitimately reused block.
 *
 * `_oz_alloc` memsets the whole object and then writes refcount 1, so this
 * holds by construction -- which is exactly why it is worth a row: the
 * sentinel's safety depends on an initialisation in a different function,
 * and nothing else says so.
 */
ZTEST(freed_slot, test_reallocating_the_slot_clears_the_sentinel)
{
	struct Node *first = Node_alloc();
	struct Node *again;
	struct OZObject *o;

	zassert_not_null(first, "the Node slab must have a slot free");
	OZObject_release((struct OZObject *)first);

	again = Node_alloc();
	zassert_not_null(again, "the freed slot must be available again");
	o = (struct OZObject *)again;
	zassert_not_equal(OZ_REFCOUNT_FREED, oz_atomic_get(&o->oz_refcount),
			  "a reused slot must not still read as freed, or every object "
			  "after the first free traps");
	zassert_equal(1, oz_atomic_get(&o->oz_refcount),
		      "a fresh object starts at one reference");

	OZObject_release(o);
}
```

## src/test_lifecycle.c
```c
/* SPDX-License-Identifier: Apache-2.0 */
/* Lifecycle tests: alloc, class_id, refcount, release */
#include <zephyr/ztest.h>
#include "Widget_ozh.h"
#include "OZObject_ozh.h"
#include "oz_dispatch.h"

ZTEST_SUITE(lifecycle, NULL, NULL, NULL, NULL, NULL);

ZTEST(lifecycle, test_alloc_returns_non_null)
{
	struct Widget *w = Widget_alloc();
	zassert_not_null(w, "Widget alloc returned NULL");
	OZObject_release((struct OZObject *)w);
}

ZTEST(lifecycle, test_alloc_sets_class_id)
{
	struct Widget *w = Widget_alloc();
	zassert_equal(OZ_CLASS_Widget, w->base._meta.class_id,
		      "Expected class id %d, got %d",
		      OZ_CLASS_Widget, w->base._meta.class_id);
	OZObject_release((struct OZObject *)w);
}

ZTEST(lifecycle, test_alloc_sets_refcount_one)
{
	struct Widget *w = Widget_alloc();
	zassert_equal(1u, __objc_refcount_get(w),
		      "Expected refcount 1, got %u", __objc_refcount_get(w));
	OZObject_release((struct OZObject *)w);
}

ZTEST(lifecycle, test_init_sets_default_tag)
{
	struct Widget *w = Widget_alloc();
	zassert_equal(0, Widget_tag(w), "Default tag should be 0");
	OZObject_release((struct OZObject *)w);
}
```

## src/test_memory.c
```c
/* SPDX-License-Identifier: Apache-2.0 */
/* Memory tests: retain/release, refcount queries */
#include <zephyr/ztest.h>
#include "Node_ozh.h"
#include "OZObject_ozh.h"
#include "oz_dispatch.h"

ZTEST_SUITE(memory, NULL, NULL, NULL, NULL, NULL);

ZTEST(memory, test_retain_increments_refcount)
{
	struct Node *n = Node_alloc();
	zassert_equal(1u, __objc_refcount_get(n));

	OZObject_retain((struct OZObject *)n);
	zassert_equal(2u, __objc_refcount_get(n));

	OZObject_retain((struct OZObject *)n);
	zassert_equal(3u, __objc_refcount_get(n));

	/* Balance releases */
	OZObject_release((struct OZObject *)n);
	OZObject_release((struct OZObject *)n);
	OZObject_release((struct OZObject *)n);
}

ZTEST(memory, test_release_decrements_refcount)
{
	struct Node *n = Node_alloc();
	OZObject_retain((struct OZObject *)n);
	OZObject_retain((struct OZObject *)n);
	zassert_equal(3u, __objc_refcount_get(n));

	OZObject_release((struct OZObject *)n);
	zassert_equal(2u, __objc_refcount_get(n));

	OZObject_release((struct OZObject *)n);
	zassert_equal(1u, __objc_refcount_get(n));

	OZObject_release((struct OZObject *)n);
}

ZTEST(memory, test_slab_alloc_and_reuse)
{
	struct Node *n1 = Node_alloc();
	zassert_not_null(n1, "First alloc should succeed");

	/* Release returns block to slab */
	OZObject_release((struct OZObject *)n1);

	/* Re-alloc should reuse the freed block */
	struct Node *n2 = Node_alloc();
	zassert_not_null(n2, "Realloc after free should succeed");
	OZObject_release((struct OZObject *)n2);
}
```

## src/test_protocol.c
```c
/* SPDX-License-Identifier: Apache-2.0 */
/* Protocol dispatch tests: vtable routing to correct class */
#include <zephyr/ztest.h>
#include "LightSwitch_ozh.h"
#include "Fan_ozh.h"
#include "OZObject_ozh.h"
#include "oz_dispatch.h"

ZTEST_SUITE(protocol, NULL, NULL, NULL, NULL, NULL);

ZTEST(protocol, test_toggle_routes_to_lightswitch)
{
	struct LightSwitch *ls = LightSwitch_alloc();
	int result = OZ_PROTOCOL_SEND_toggle((struct OZObject *)ls);
	zassert_equal(1, result, "LightSwitch toggle should return 1");
	OZObject_release((struct OZObject *)ls);
}

ZTEST(protocol, test_toggle_routes_to_fan)
{
	struct Fan *f = Fan_alloc();
	int result = OZ_PROTOCOL_SEND_toggle((struct OZObject *)f);
	zassert_equal(11, result, "Fan toggle should return 11");
	OZObject_release((struct OZObject *)f);
}

ZTEST(protocol, test_toggle_is_stateful)
{
	struct LightSwitch *ls = LightSwitch_alloc();

	/* First toggle: 0 -> 1 */
	int r1 = OZ_PROTOCOL_SEND_toggle((struct OZObject *)ls);
	zassert_equal(1, r1, "First toggle should return 1");

	/* Second toggle: 1 -> 0 */
	int r2 = OZ_PROTOCOL_SEND_toggle((struct OZObject *)ls);
	zassert_equal(0, r2, "Second toggle should return 0");

	OZObject_release((struct OZObject *)ls);
}
```

## src/test_timer.c
```c
/* SPDX-License-Identifier: Apache-2.0 */
/* OZTimer regression tests for OZ-078: verify OZTimer is in the CMake
 * transpile pipeline and __oz_timer_setup is available in the Zephyr PAL. */
#include <zephyr/ztest.h>
#include "OZTimer_ozh.h"
#include "TimerZephyrTarget_ozh.h"
#include "TimerZephyrTest_ozh.h"
#include "OZObject_ozh.h"
#include "oz_dispatch.h"

ZTEST_SUITE(timer, NULL, NULL, NULL, NULL, NULL);

ZTEST(timer, test_timer_alloc)
{
	struct OZTimer *t = OZTimer_alloc();
	zassert_not_null(t, "OZTimer alloc returned NULL");
	OZObject_release((struct OZObject *)t);
}

ZTEST(timer, test_timer_init_sets_userdata)
{
	struct TimerZephyrTarget *tgt = TimerZephyrTarget_initWithValue_(
		TimerZephyrTarget_alloc(), 42);
	zassert_not_null(tgt, "TimerZephyrTarget alloc failed");

	struct TimerZephyrTest *tt = TimerZephyrTest_initWithTarget_(
		TimerZephyrTest_alloc(), tgt);
	zassert_not_null(tt, "TimerZephyrTest alloc failed");

	struct OZTimer *timer = TimerZephyrTest_timer(tt);
	zassert_not_null(timer, "timer getter returned NULL");

	struct OZObject *ud = OZTimer_userdata(timer);
	zassert_equal_ptr(ud, (struct OZObject *)tgt,
			  "userdata should point to TimerZephyrTarget");

	OZObject_release((struct OZObject *)tt);
	OZObject_release((struct OZObject *)tgt);
}

ZTEST(timer, test_timer_expiry_fires_block)
{
	struct TimerZephyrTarget *tgt = TimerZephyrTarget_initWithValue_(
		TimerZephyrTarget_alloc(), 10);
	struct TimerZephyrTest *tt = TimerZephyrTest_initWithTarget_(
		TimerZephyrTest_alloc(), tgt);
	struct OZTimer *timer = TimerZephyrTest_timer(tt);

	/* Simulate k_timer expiry by calling the callback directly */
	timer->_timer.expiry_fn(&timer->_timer);

	zassert_equal(11, TimerZephyrTarget_value(tgt),
		      "Expected value=11 after expiry callback");

	OZObject_release((struct OZObject *)tt);
	OZObject_release((struct OZObject *)tgt);
}
```
